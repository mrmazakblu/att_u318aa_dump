/dts-v1/;

/ {
	model = "mt6739";
	compatible = "mediatek,mt6739";
	interrupt-parent = <0x01>;
	#address-cells = <0x02>;
	#size-cells = <0x02>;

	chosen {
		bootargs = "console=tty0 console=ttyMT3,921600n1 vmalloc=400M \t\t\tslub_debug=OFZPU page_owner=on swiotlb=noforce \t\t\tcgroup.memory=nosocket,nokmem \t\t\tandroidboot.hardware=mt6739 maxcpus=8 \t\t\tfirmware_class.path=/vendor/firmware loop.max_part=7";
		phandle = <0x3c>;
	};

	pmu {
		compatible = "arm,cortex-a7-pmu";
		interrupt-parent = <0x02>;
		interrupts = <0x01 0x07 0x08>;
	};

	cpus {
		#address-cells = <0x01>;
		#size-cells = <0x00>;

		cpu@0 {
			device_type = "cpu";
			compatible = "arm,cortex-a53";
			reg = <0x00>;
			enable-method = "psci";
			cpu-release-addr = <0x00 0x40000200>;
			clock-frequency = <0x77359400>;
			cpu-idle-states = <0x03 0x04 0x05 0x06 0x07 0x08 0x09>;
			phandle = <0x0a>;
		};

		cpu@001 {
			device_type = "cpu";
			compatible = "arm,cortex-a53";
			reg = <0x01>;
			enable-method = "psci";
			cpu-release-addr = <0x00 0x40000200>;
			clock-frequency = <0x61a1e580>;
			cpu-idle-states = <0x03 0x04 0x05 0x06 0x07 0x08 0x09>;
			phandle = <0x0b>;
		};

		cpu@002 {
			device_type = "cpu";
			compatible = "arm,cortex-a53";
			reg = <0x02>;
			enable-method = "psci";
			cpu-release-addr = <0x00 0x40000200>;
			clock-frequency = <0x61a1e580>;
			cpu-idle-states = <0x03 0x04 0x05 0x06 0x07 0x08 0x09>;
			phandle = <0x0c>;
		};

		cpu@003 {
			device_type = "cpu";
			compatible = "arm,cortex-a53";
			reg = <0x03>;
			enable-method = "psci";
			cpu-release-addr = <0x00 0x40000200>;
			clock-frequency = <0x61a1e580>;
			cpu-idle-states = <0x03 0x04 0x05 0x06 0x07 0x08 0x09>;
			phandle = <0x0d>;
		};

		cpu-map {

			cluster0 {

				core0 {
					cpu = <0x0a>;
				};

				core1 {
					cpu = <0x0b>;
				};

				core2 {
					cpu = <0x0c>;
				};

				core3 {
					cpu = <0x0d>;
				};
			};
		};

		idle-states {
			entry-method = "arm,psci";

			standby {
				compatible = "arm,idle-state";
				arm,psci-suspend-param = <0x01>;
				entry-latency-us = <0x258>;
				exit-latency-us = <0x258>;
				min-residency-us = <0x4b0>;
				phandle = <0x03>;
			};

			mcdi-cpu {
				compatible = "arm,idle-state";
				arm,psci-suspend-param = <0x10001>;
				entry-latency-us = <0x258>;
				exit-latency-us = <0x258>;
				min-residency-us = <0x4b0>;
				phandle = <0x04>;
			};

			mcdi-cluster {
				compatible = "arm,idle-state";
				arm,psci-suspend-param = <0x1010001>;
				entry-latency-us = <0x258>;
				exit-latency-us = <0x258>;
				min-residency-us = <0x4b0>;
				phandle = <0x05>;
			};

			sodi {
				compatible = "arm,idle-state";
				arm,psci-suspend-param = <0x1010002>;
				entry-latency-us = <0x320>;
				exit-latency-us = <0x3e8>;
				min-residency-us = <0x7d0>;
				phandle = <0x06>;
			};

			sodi3 {
				compatible = "arm,idle-state";
				arm,psci-suspend-param = <0x1010003>;
				entry-latency-us = <0x320>;
				exit-latency-us = <0x3e8>;
				min-residency-us = <0x7d0>;
				phandle = <0x07>;
			};

			dpidle {
				compatible = "arm,idle-state";
				arm,psci-suspend-param = <0x1010004>;
				entry-latency-us = <0x320>;
				exit-latency-us = <0x3e8>;
				min-residency-us = <0x7d0>;
				phandle = <0x08>;
			};

			suspend {
				compatible = "arm,idle-state";
				arm,psci-suspend-param = <0x1010005>;
				entry-latency-us = <0x320>;
				exit-latency-us = <0x3e8>;
				min-residency-us = <0x7d0>;
				phandle = <0x09>;
			};
		};
	};

	mobicore {
		compatible = "trustonic,mobicore";
		interrupts = <0x00 0x6e 0x01>;
	};

	tkcore {
		compatible = "trustkernel,tkcore";
		interrupts = <0x00 0x6f 0x01>;
	};

	psci {
		compatible = "arm,psci-0.2";
		method = "smc";
	};

	memory {
		device_type = "memory";
		reg = <0x00 0x40000000 0x00 0x20000000>;
	};

	cpu_dbgapb {
		compatible = "mediatek,hw_dbg";
		num = <0x04>;
		reg = <0x00 0xd410000 0x00 0x1000 0x00 0xd510000 0x00 0x1000 0x00 0xd610000 0x00 0x1000 0x00 0xd710000 0x00 0x1000>;
		phandle = <0x3d>;
	};

	atf_logger {
		compatible = "mediatek,atf_logger";
		interrupts = <0x00 0xf1 0x01>;
	};

	amms_control {
		compatible = "mediatek,amms";
		interrupts = <0x00 0x7b 0x01>;
	};

	utos {
		compatible = "microtrust,utos";
		interrupts = <0x00 0x83 0x01 0x00 0x84 0x01>;
	};

	utos_tester {
		compatible = "microtrust,tester-v1";
	};

	reserved-memory {
		#address-cells = <0x02>;
		#size-cells = <0x02>;
		ranges;
		phandle = <0x3e>;

		consys-reserve-memory {
			compatible = "mediatek,consys-reserve-memory";
			#address-cells = <0x02>;
			#size-cells = <0x02>;
			no-map;
			size = <0x00 0x200000>;
			alignment = <0x00 0x200000>;
			alloc-ranges = <0x00 0x40000000 0x00 0x38000000>;
		};
	};

	interrupt-controller@0c000000 {
		compatible = "arm,gic-v3";
		#interrupt-cells = <0x03>;
		#address-cells = <0x02>;
		#size-cells = <0x02>;
		#redistributor-regions = <0x01>;
		interrupt-parent = <0x02>;
		interrupt-controller;
		reg = <0x00 0xc000000 0x00 0x40000 0x00 0xc080000 0x00 0x200000 0x00 0x10200620 0x00 0x1000>;
		interrupts = <0x01 0x09 0x04>;
		mediatek,reg_len_pol0 = <0x08>;
		phandle = <0x02>;
	};

	led_red_gpio {
		compatible = "mediatek,led-red-pwm";
		phandle = <0x3f>;
	};

	intpol-controller@0x10200620 {
		compatible = "mediatek,mt6739-sysirq\0mediatek,mt6577-sysirq";
		interrupt-controller;
		#interrupt-cells = <0x03>;
		interrupt-parent = <0x02>;
		reg = <0x00 0x10200620 0x00 0x20>;
		phandle = <0x01>;
	};

	chipid@08000000 {
		compatible = "mediatek,chipid";
		reg = <0x00 0x8000000 0x00 0x04 0x00 0x8000004 0x00 0x04 0x00 0x8000008 0x00 0x04 0x00 0x800000c 0x00 0x04>;
	};

	timer {
		compatible = "arm,armv8-timer";
		interrupt-parent = <0x02>;
		interrupts = <0x01 0x0d 0x08 0x01 0x0e 0x08 0x01 0x0b 0x08 0x01 0x0a 0x08>;
		clock-frequency = <0xc65d40>;
	};

	clk26m {
		compatible = "fixed-clock";
		#clock-cells = <0x00>;
		clock-frequency = <0x18cba80>;
		phandle = <0x1b>;
	};

	topckgen@10000000 {
		compatible = "mediatek,topckgen\0syscon";
		reg = <0x00 0x10000000 0x00 0x1000 0x00 0x1000c000 0x00 0x1000>;
		#clock-cells = <0x01>;
		phandle = <0x29>;
	};

	infracfg_ao@10001000 {
		compatible = "mediatek,infracfg_ao\0syscon";
		reg = <0x00 0x10001000 0x00 0x1000>;
		interrupts = <0x00 0x93 0x01>;
		#clock-cells = <0x01>;
		phandle = <0x1d>;
	};

	scpsys@10001000 {
		compatible = "mediatek,scpsys";
		reg = <0x00 0x10001000 0x00 0x1000 0x00 0x10006000 0x00 0x1000 0x00 0x1020e000 0x00 0x1000>;
		#clock-cells = <0x01>;
		phandle = <0x1e>;
	};

	clk32k {
		compatible = "fixed-clock";
		#clock-cells = <0x00>;
		clock-frequency = <0x7d00>;
		phandle = <0x1a>;
	};

	io_cfg_lt@10002000 {
		compatible = "mediatek,io_cfg_lt";
		reg = <0x00 0x10002000 0x00 0x200>;
		phandle = <0x0f>;
	};

	syscfg_pctl_lt@10002000 {
		compatible = "mediatek,pctl-lt-syscfg\0syscon";
		reg = <0x00 0x10002000 0x00 0x1000>;
		phandle = <0x40>;
	};

	io_cfg_lm@10002200 {
		compatible = "mediatek,io_cfg_lm";
		reg = <0x00 0x10002200 0x00 0x200>;
		phandle = <0x10>;
	};

	syscfg_pctl_lm@10002200 {
		compatible = "mediatek,pctl-lm-syscfg\0syscon";
		reg = <0x00 0x10002200 0x00 0x1000>;
		phandle = <0x41>;
	};

	io_cfg_lb@10002400 {
		compatible = "mediatek,io_cfg_lb";
		reg = <0x00 0x10002400 0x00 0x200>;
		phandle = <0x11>;
	};

	syscfg_pctl_lb@10002400 {
		compatible = "mediatek,pctl-lb-syscfg\0syscon";
		reg = <0x00 0x10002400 0x00 0x1000>;
		phandle = <0x42>;
	};

	io_cfg_bl@10002600 {
		compatible = "mediatek,io_cfg_bl";
		reg = <0x00 0x10002600 0x00 0x200>;
		phandle = <0x12>;
	};

	syscfg_pctl_bl@10002600 {
		compatible = "mediatek,pctl-bl-syscfg\0syscon";
		reg = <0x00 0x10002600 0x00 0x1000>;
		phandle = <0x43>;
	};

	io_cfg_bm@10002800 {
		compatible = "mediatek,io_cfg_bm";
		reg = <0x00 0x10002800 0x00 0x200>;
		phandle = <0x13>;
	};

	syscfg_pctl_bm@10002800 {
		compatible = "mediatek,pctl-bm-syscfg\0syscon";
		reg = <0x00 0x10002800 0x00 0x1000>;
		phandle = <0x44>;
	};

	io_cfg_rb@10002a00 {
		compatible = "mediatek,io_cfg_rb";
		reg = <0x00 0x10002a00 0x00 0x200>;
		phandle = <0x14>;
	};

	syscfg_pctl_rb@10002a00 {
		compatible = "mediatek,pctl-rb-syscfg\0syscon";
		reg = <0x00 0x10002a00 0x00 0x1000>;
		phandle = <0x45>;
	};

	io_cfg_rt@10002c00 {
		compatible = "mediatek,io_cfg_rt";
		reg = <0x00 0x10002c00 0x00 0x200>;
		phandle = <0x15>;
	};

	syscfg_pctl_bl@10002c00 {
		compatible = "mediatek,pctl-rt-syscfg\0syscon";
		reg = <0x00 0x10002c00 0x00 0x1000>;
		phandle = <0x46>;
	};

	pericfg@10003000 {
		compatible = "mediatek,pericfg";
		reg = <0x00 0x10003000 0x00 0x1000>;
	};

	efuse_dbg@10004000 {
		compatible = "mediatek,efuse_dbg";
		reg = <0x00 0x10004000 0x00 0x1000>;
	};

	gpio {
		compatible = "mediatek,gpio_usage_mapping";
		phandle = <0x47>;
	};

	gpio@10005000 {
		compatible = "mediatek,gpio";
		reg = <0x00 0x10005000 0x00 0x1000>;
		phandle = <0x0e>;
	};

	syscfg_pctl_a@10005000 {
		compatible = "mediatek,pctl-a-syscfg\0syscon";
		reg = <0x00 0x10005000 0x00 0x1000>;
		phandle = <0x48>;
	};

	accdet {
		compatible = "mediatek,pmic-accdet";
		phandle = <0x49>;
	};

	1000b000.pinctrl {
		compatible = "mediatek,mt6739-pinctrl";
		reg_bases = <0x0e 0x0f 0x10 0x11 0x12 0x13 0x14 0x15>;
		reg_base_eint = <0x16>;
		pins-are-numbered;
		gpio-controller;
		gpio-ranges = <0x17 0x00 0x00 0xa8>;
		#gpio-cells = <0x02>;
		interrupt-controller;
		#interrupt-cells = <0x04>;
		interrupts = <0x00 0xa7 0x04>;
		phandle = <0x17>;
	};

	sleep@10006000 {
		compatible = "mediatek,sleep";
		reg = <0x00 0x10006000 0x00 0x1000>;
		interrupts = <0x00 0xb1 0x08>;
		wakeup-source = <0x18 0x00 0x04 0x19 0x03 0x2000000>;
	};

	toprgu@10007000 {
		compatible = "mediatek,toprgu";
		reg = <0x00 0x10007000 0x00 0x1000>;
		interrupts = <0x00 0x8b 0x00>;
	};

	apxgpt@10008000 {
		compatible = "mediatek,apxgpt";
		reg = <0x00 0x10008000 0x00 0x1000>;
		interrupts = <0x00 0xa6 0x08>;
		clocks = <0x1a>;
	};

	hacc@1000a000 {
		compatible = "mediatek,hacc";
		reg = <0x00 0x1000a000 0x00 0x1000>;
		interrupts = <0x00 0xb5 0x08>;
	};

	apirq@1000b000 {
		compatible = "mediatek,apirq";
		reg = <0x00 0x1000b000 0x00 0x1000>;
		interrupts = <0x00 0xa7 0x04>;
		phandle = <0x16>;
	};

	apmixed@1000c000 {
		compatible = "mediatek,apmixed\0mediatek,apmixedsys\0syscon";
		reg = <0x00 0x1000c000 0x00 0x1000>;
		#clock-cells = <0x01>;
		phandle = <0x36>;
	};

	fhctl@1000ce00 {
		compatible = "mediatek,fhctl";
		reg = <0x00 0x1000ce00 0x00 0x100>;
	};

	pwrap@1000d000 {
		compatible = "mediatek,mt6739-pwrap";
		reg = <0x00 0x1000d000 0x00 0x1000>;
		reg-names = "pwrap";
		interrupts = <0x00 0xaf 0x04>;
		clocks = <0x1b 0x1b>;
		clock-names = "spi\0wrap";
		phandle = <0x1c>;

		mt6357-pmic {
			interrupt-parent = <0x17>;
			interrupts = <0xb6 0x04 0xb6 0x00>;
			status = "okay";
			compatible = "mediatek,mt6357-pmic";
			interrupt-controller;
			#interrupt-cells = <0x02>;
			mediatek,num-pmic-irqs = <0x91>;
			mediatek,pmic-irqs = <0x00 0x00 0x01 0x00 0x02 0x00 0x03 0x00 0x04 0x00 0x05 0x00 0x10 0x01 0x11 0x01 0x12 0x01 0x13 0x01 0x14 0x01 0x15 0x01 0x16 0x01 0x17 0x01 0x18 0x01 0x19 0x01 0x1a 0x01 0x1b 0x01 0x1c 0x01 0x1d 0x01 0x1e 0x01 0x1f 0x01 0x20 0x01 0x21 0x01 0x22 0x01 0x23 0x01 0x24 0x01 0x25 0x01 0x26 0x01 0x27 0x01 0x28 0x01 0x29 0x01 0x30 0x02 0x31 0x02 0x32 0x02 0x33 0x02 0x34 0x02 0x35 0x02 0x36 0x02 0x37 0x02 0x3a 0x02 0x3b 0x02 0x3c 0x02 0x3d 0x02 0x40 0x03 0x50 0x04 0x51 0x04 0x52 0x04 0x53 0x04 0x54 0x04 0x60 0x04 0x61 0x04 0x72 0x05 0x73 0x05 0x78 0x05 0x79 0x05 0x80 0x06 0x85 0x06 0x86 0x06 0x87 0x06 0x90 0x07>;
			interrupt-names = "vproc_oc\0vcore_oc\0vmodem_oc\0vs1_oc\0vpa_oc\0vcore_preoc\0vfe28_oc\0vxo22_oc\0vrf18_oc\0vrf12_oc\0vefuse_oc\0vcn33_oc\0vcn28_oc\0vcn18_oc\0vcama_oc\0vcamd_oc\0vcamio_oc\0vldo28_oc\0vusb33_oc\0vaux18_oc\0vaud28_oc\0vio28_oc\0vio18_oc\0vsram_proc_oc\0vsram_others_oc\0vibr_oc\0vdram_oc\0vmc_oc\0vmch_oc\0vemc_oc\0vsim1_oc\0vsim2_oc\0pwrkey\0homekey\0pwrkey_r\0homekey_r\0ni_lbat_int\0chrdet\0chrdet_edge\0vcdt_hv_det\0watchdog\0vbaton_undet\0bvalid_det\0ov\0rtc\0fg_bat0_h\0fg_bat0_l\0fg_cur_h\0fg_cur_l\0fg_zcv\0baton_lv\0baton_ht\0bat_h\0bat_l\0auxadc_imp\0nag_c_dltv\0audio\0accdet\0accdet_eint0\0accdet_eint1\0spi_cmd_alert";
			phandle = <0x4a>;

			mt-pmic {
				compatible = "mediatek,mt-pmic";
				interrupts = <0x30 0x04 0x32 0x04 0x31 0x04 0x33 0x04 0x72 0x04 0x73 0x04 0x52 0x04 0x53 0x04>;
				interrupt-names = "pwrkey\0pwrkey_r\0homekey\0homekey_r\0bat_h\0bat_l\0fg_cur_h\0fg_cur_l";
				phandle = <0x4b>;
			};

			mt635x-auxadc {
				compatible = "mediatek,mt6357-auxadc";
				#io-channel-cells = <0x01>;
				phandle = <0x4c>;

				batadc {
					channel = <0x00>;
					resistance-ratio = <0x03 0x01>;
					avg-num = <0x80>;
				};

				isense {
					channel = <0x01>;
					resistance-ratio = <0x03 0x01>;
					avg-num = <0x80>;
				};

				vcdt {
					channel = <0x02>;
				};

				bat_temp {
					channel = <0x03>;
					resistance-ratio = <0x01 0x01>;
				};

				chip_temp {
					channel = <0x05>;
				};

				vcore_temp {
					channel = <0x06>;
				};

				vproc_temp {
					channel = <0x07>;
				};

				accdet {
					channel = <0x09>;
				};

				tsx_temp {
					channel = <0x0b>;
					avg-num = <0x80>;
				};

				hpofs_cal {
					channel = <0x0c>;
					avg-num = <0x100>;
				};

				dcxo_temp {
					channel = <0x0d>;
					avg-num = <0x10>;
				};

				vbif {
					channel = <0x0e>;
					resistance-ratio = <0x01 0x01>;
				};
			};

			buck_regulators {

				buck_vs1 {
					regulator-name = "vs1";
					regulator-min-microvolt = <0x124f80>;
					regulator-max-microvolt = <0x2191c0>;
					regulator-ramp-delay = <0x30d4>;
					regulator-enable-ramp-delay = <0xdc>;
					phandle = <0x4d>;
				};

				buck_vmodem {
					regulator-name = "vmodem";
					regulator-min-microvolt = <0x7a120>;
					regulator-max-microvolt = <0x123716>;
					regulator-ramp-delay = <0x186a>;
					regulator-enable-ramp-delay = <0xdc>;
					phandle = <0x4e>;
				};

				buck_vcore {
					regulator-name = "vcore";
					regulator-min-microvolt = <0x7ea5e>;
					regulator-max-microvolt = <0x1406f4>;
					regulator-ramp-delay = <0x186a>;
					regulator-enable-ramp-delay = <0xdc>;
					phandle = <0x4f>;
				};

				buck_vproc {
					regulator-name = "vproc";
					regulator-min-microvolt = <0x7ea5e>;
					regulator-max-microvolt = <0x1406f4>;
					regulator-ramp-delay = <0x186a>;
					regulator-enable-ramp-delay = <0xdc>;
					phandle = <0x50>;
				};

				buck_vpa {
					regulator-name = "vpa";
					regulator-min-microvolt = <0x7a120>;
					regulator-max-microvolt = <0x37b1d0>;
					regulator-ramp-delay = <0xc350>;
					regulator-enable-ramp-delay = <0xdc>;
					phandle = <0x51>;
				};
			};

			ldo_regulators {

				ldo_vfe28 {
					compatible = "regulator-fixed";
					regulator-name = "vfe28";
					regulator-min-microvolt = <0x2ab980>;
					regulator-max-microvolt = <0x2ab980>;
					regulator-enable-ramp-delay = <0x108>;
					phandle = <0x52>;
				};

				ldo_vxo22 {
					regulator-name = "vxo22";
					regulator-min-microvolt = <0x2191c0>;
					regulator-max-microvolt = <0x249f00>;
					regulator-enable-ramp-delay = <0x6e>;
					phandle = <0x53>;
				};

				ldo_vrf18 {
					compatible = "regulator-fixed";
					regulator-name = "vrf18";
					regulator-min-microvolt = <0x1b7740>;
					regulator-max-microvolt = <0x1b7740>;
					regulator-enable-ramp-delay = <0x6e>;
					phandle = <0x54>;
				};

				ldo_vrf12 {
					compatible = "regulator-fixed";
					regulator-name = "vrf12";
					regulator-min-microvolt = <0x124f80>;
					regulator-max-microvolt = <0x124f80>;
					regulator-enable-ramp-delay = <0x6e>;
					phandle = <0x55>;
				};

				ldo_vefuse {
					regulator-name = "vefuse";
					regulator-min-microvolt = <0x124f80>;
					regulator-max-microvolt = <0x325aa0>;
					regulator-enable-ramp-delay = <0x108>;
					phandle = <0x56>;
				};

				ldo_vcn33_bt {
					regulator-name = "vcn33_bt";
					regulator-min-microvolt = <0x325aa0>;
					regulator-max-microvolt = <0x3567e0>;
					regulator-enable-ramp-delay = <0x108>;
					phandle = <0x57>;
				};

				ldo_vcn33_wifi {
					regulator-name = "vcn33_wifi";
					regulator-min-microvolt = <0x325aa0>;
					regulator-max-microvolt = <0x3567e0>;
					regulator-enable-ramp-delay = <0x108>;
					phandle = <0x58>;
				};

				ldo_vcn28 {
					compatible = "regulator-fixed";
					regulator-name = "vcn28";
					regulator-min-microvolt = <0x2ab980>;
					regulator-max-microvolt = <0x2ab980>;
					regulator-enable-ramp-delay = <0x108>;
					phandle = <0x59>;
				};

				ldo_vcn18 {
					compatible = "regulator-fixed";
					regulator-name = "vcn18";
					regulator-min-microvolt = <0x1b7740>;
					regulator-max-microvolt = <0x1b7740>;
					regulator-enable-ramp-delay = <0x108>;
					phandle = <0x5a>;
				};

				ldo_vcama {
					regulator-name = "vcama";
					regulator-min-microvolt = <0x2625a0>;
					regulator-max-microvolt = <0x2ab980>;
					regulator-enable-ramp-delay = <0x108>;
					phandle = <0x5b>;
				};

				ldo_vcamd {
					regulator-name = "vcamd";
					regulator-min-microvolt = <0xf4240>;
					regulator-max-microvolt = <0x1b7740>;
					regulator-enable-ramp-delay = <0x108>;
					phandle = <0x5c>;
				};

				ldo_vcamio {
					compatible = "regulator-fixed";
					regulator-name = "vcamio";
					regulator-min-microvolt = <0x1b7740>;
					regulator-max-microvolt = <0x1b7740>;
					regulator-enable-ramp-delay = <0x108>;
					phandle = <0x5d>;
				};

				ldo_vldo28 {
					regulator-name = "vldo28";
					regulator-min-microvolt = <0x2ab980>;
					regulator-max-microvolt = <0x2dc6c0>;
					regulator-enable-ramp-delay = <0x108>;
					phandle = <0x5e>;
				};

				ldo_vsram_others {
					regulator-name = "vsram_others";
					regulator-min-microvolt = <0x7ea5e>;
					regulator-max-microvolt = <0x1406f4>;
					regulator-ramp-delay = <0x186a>;
					regulator-enable-ramp-delay = <0x6e>;
					phandle = <0x5f>;
				};

				ldo_vsram_proc {
					regulator-name = "vsram_proc";
					regulator-min-microvolt = <0x7ea5e>;
					regulator-max-microvolt = <0x1406f4>;
					regulator-ramp-delay = <0x186a>;
					regulator-enable-ramp-delay = <0x6e>;
					phandle = <0x60>;
				};

				ldo_vaux18 {
					compatible = "regulator-fixed";
					regulator-name = "vaux18";
					regulator-min-microvolt = <0x1b7740>;
					regulator-max-microvolt = <0x1b7740>;
					regulator-enable-ramp-delay = <0x108>;
					phandle = <0x61>;
				};

				ldo_vaud28 {
					compatible = "regulator-fixed";
					regulator-name = "vaud28";
					regulator-min-microvolt = <0x2ab980>;
					regulator-max-microvolt = <0x2ab980>;
					regulator-enable-ramp-delay = <0x108>;
					phandle = <0x62>;
				};

				ldo_vio28 {
					compatible = "regulator-fixed";
					regulator-name = "vio28";
					regulator-min-microvolt = <0x2ab980>;
					regulator-max-microvolt = <0x2ab980>;
					regulator-enable-ramp-delay = <0x108>;
					phandle = <0x63>;
				};

				ldo_vio18 {
					compatible = "regulator-fixed";
					regulator-name = "vio18";
					regulator-min-microvolt = <0x1b7740>;
					regulator-max-microvolt = <0x1b7740>;
					regulator-enable-ramp-delay = <0x108>;
					phandle = <0x64>;
				};

				ldo_vdram {
					regulator-name = "vdram";
					regulator-min-microvolt = <0x10c8e0>;
					regulator-max-microvolt = <0x124f80>;
					regulator-enable-ramp-delay = <0xce4>;
					phandle = <0x65>;
				};

				ldo_vmc {
					regulator-name = "vmc";
					regulator-min-microvolt = <0x1b7740>;
					regulator-max-microvolt = <0x325aa0>;
					regulator-enable-ramp-delay = <0x2c>;
					phandle = <0x33>;
				};

				ldo_vmch {
					regulator-name = "vmch";
					regulator-min-microvolt = <0x2c4020>;
					regulator-max-microvolt = <0x325aa0>;
					regulator-enable-ramp-delay = <0x2c>;
					phandle = <0x32>;
				};

				ldo_vemc {
					regulator-name = "vemc";
					regulator-min-microvolt = <0x2c4020>;
					regulator-max-microvolt = <0x325aa0>;
					regulator-enable-ramp-delay = <0x2c>;
					phandle = <0x2c>;
				};

				ldo_vsim1 {
					regulator-name = "vsim1";
					regulator-min-microvolt = <0x19f0a0>;
					regulator-max-microvolt = <0x2f4d60>;
					regulator-enable-ramp-delay = <0x108>;
					phandle = <0x66>;
				};

				ldo_vsim2 {
					regulator-name = "vsim2";
					regulator-min-microvolt = <0x19f0a0>;
					regulator-max-microvolt = <0x2f4d60>;
					regulator-enable-ramp-delay = <0x108>;
					phandle = <0x67>;
				};

				ldo_vibr {
					regulator-name = "vibr";
					regulator-min-microvolt = <0x124f80>;
					regulator-max-microvolt = <0x325aa0>;
					regulator-enable-ramp-delay = <0x2c>;
					phandle = <0x68>;
				};

				ldo_vusb33 {
					regulator-name = "vusb33";
					regulator-min-microvolt = <0x2dc6c0>;
					regulator-max-microvolt = <0x2f4d60>;
					regulator-enable-ramp-delay = <0x108>;
					phandle = <0x69>;
				};
			};
		};
	};

	pwraphal@ {
		compatible = "mediatek,pwraph";
		mediatek,pwrap-regmap = <0x1c>;
		phandle = <0x6a>;
	};

	sleep_reg_md@1000f000 {
		compatible = "mediatek,sleep_reg_md";
		reg = <0x00 0x1000f000 0x00 0x1000>;
	};

	kp@10010000 {
		compatible = "mediatek,kp";
		reg = <0x00 0x10010000 0x00 0x1000>;
		interrupts = <0x00 0xb0 0x02>;
		phandle = <0x18>;
	};

	topmisc@10011000 {
		compatible = "mediatek,topmisc";
		reg = <0x00 0x10011000 0x00 0x1000>;
	};

	dvfsrc_top@10012000 {
		compatible = "mediatek,dvfsrc_top";
		reg = <0x00 0x10012000 0x00 0x1000>;
	};

	mbist_ao@10013000 {
		compatible = "mediatek,mbist_ao";
		reg = <0x00 0x10013000 0x00 0x1000>;
	};

	apcldmain_ao@10014000 {
		compatible = "mediatek,apcldmain_ao";
		reg = <0x00 0x10014000 0x00 0x400>;
	};

	apcldmaout_ao@10014400 {
		compatible = "mediatek,apcldmaout_ao";
		reg = <0x00 0x10014400 0x00 0x400>;
	};

	apcldmamisc_ao@10014800 {
		compatible = "mediatek,apcldmamisc_ao";
		reg = <0x00 0x10014800 0x00 0x400>;
	};

	apcldmamisc_ao@10014c00 {
		compatible = "mediatek,apcldmamisc_ao";
		reg = <0x00 0x10014c00 0x00 0x400>;
	};

	aes_top0@10016000 {
		compatible = "mediatek,aes_top0";
		reg = <0x00 0x10016000 0x00 0x1000>;
	};

	sys_timer@10017000 {
		compatible = "mediatek,sys_timer";
		reg = <0x00 0x10017000 0x00 0x1000 0x00 0x10218da0 0x00 0x14>;
		reg-names = "sys_timer_base\0sysram_base";
		interrupts = <0x00 0xba 0x04>;
		mediatek,sysram-size = <0x14>;
	};

	modem_temp_share@10018000 {
		compatible = "mediatek,modem_temp_share";
		reg = <0x00 0x10018000 0x00 0x1000>;
	};

	security_ao@1001a000 {
		compatible = "mediatek,security_ao";
		reg = <0x00 0x1001a000 0x00 0x1000>;
	};

	topckgen_ao@1001b000 {
		compatible = "mediatek,topckgen_ao";
		reg = <0x00 0x1001b000 0x00 0x1000>;
	};

	dramc0@1001d000 {
		compatible = "mediatek,dramc0";
		reg = <0x00 0x1001d000 0x00 0x1000>;
	};

	dramc@1001d000 {
		compatible = "mediatek,dramc";
		reg = <0x00 0x1001d000 0x00 0x1000 0x00 0x1021d000 0x00 0x1000 0x00 0x1001e000 0x00 0x1000>;
	};

	ddrphy@1001e000 {
		compatible = "mediatek,ddrphy";
		reg = <0x00 0x1001e000 0x00 0x1000>;
	};

	mdcldmain_ao@10015000 {
		compatible = "mediatek,mdcldmain_ao";
		reg = <0x00 0x10015000 0x00 0x400>;
	};

	mdcldmaout_ao@10015400 {
		compatible = "mediatek,mdcldmaout_ao";
		reg = <0x00 0x10015400 0x00 0x400>;
	};

	mdcldmamisc_ao@10015800 {
		compatible = "mediatek,mdcldmamisc_ao";
		reg = <0x00 0x10015800 0x00 0x400>;
	};

	sys_cirq@10204000 {
		compatible = "mediatek,sys_cirq";
		reg = <0x00 0x10204000 0x00 0x1000>;
		mediatek,cirq_num = <0xa8>;
		mediatek,spi_start_offset = <0x48>;
		interrupts = <0x00 0xf0 0x08>;
	};

	mcucfg@10200000 {
		compatible = "mediatek,mcucfg";
		reg = <0x00 0x10200000 0x00 0x1000>;
		interrupts = <0x00 0x00 0x08>;
	};

	m4u@10205000 {
		cell-index = <0x00>;
		compatible = "mediatek,m4u";
		reg = <0x00 0x10205000 0x00 0x1000>;
		interrupts = <0x00 0x9e 0x08>;
	};

	devapc@10207000 {
		compatible = "mediatek,devapc";
		reg = <0x00 0x10207000 0x00 0x1000>;
		interrupts = <0x00 0x8e 0x08>;
		clocks = <0x1d 0x2a>;
		clock-names = "devapc-infra-clock";
	};

	bus_dbg@10208000 {
		compatible = "mediatek,bus_dbg-v2";
		reg = <0x00 0x10208000 0x00 0x1000 0x00 0x10001000 0x00 0x1000>;
		mediatek,bus_dbg_con_offset = <0x2fc>;
		interrupts = <0x00 0x8d 0x08>;
	};

	ap_ccif0@10209000 {
		compatible = "mediatek,ap_ccif0";
		reg = <0x00 0x10209000 0x00 0x1000>;
		interrupts = <0x00 0x94 0x08>;
	};

	md_ccif0@1020a000 {
		compatible = "mediatek,md_ccif0";
		reg = <0x00 0x1020a000 0x00 0x1000>;
	};

	ap_ccif1@1020b000 {
		compatible = "mediatek,ap_ccif1";
		reg = <0x00 0x1020b000 0x00 0x1000>;
		interrupts = <0x00 0x96 0x08>;
	};

	md_ccif1@1020c000 {
		compatible = "mediatek,md_ccif1";
		reg = <0x00 0x1020c000 0x00 0x1000>;
	};

	infra_mbist@1020d000 {
		compatible = "mediatek,infra_mbist";
		reg = <0x00 0x1020d000 0x00 0x1000>;
	};

	infracfg@1020e000 {
		compatible = "mediatek,infracfg";
		reg = <0x00 0x1020e000 0x00 0x1000>;
	};

	hwrng {
		compatible = "mediatek,mt67xx-rng";
		phandle = <0x6b>;
	};

	dxcc_sec@10210000 {
		compatible = "mediatek,dxcc_sec";
		reg = <0x00 0x10210000 0x00 0x1000>;
		interrupts = <0x00 0xa2 0x04>;
	};

	md2md_md1_ccif0@10211000 {
		compatible = "mediatek,md2md_md1_ccif0";
		reg = <0x00 0x10211000 0x00 0x1000>;
	};

	cq_dma@10212000 {
		compatible = "mediatek,mt-cqdma-v1";
		reg = <0x00 0x10212080 0x00 0x80>;
		interrupts = <0x00 0x72 0x08>;
		nr_channel = <0x01>;
		keep_clock_ao = "yes";
		clocks = <0x1d 0x44>;
		clock-names = "cqdma";
	};

	md2md_md2_ccif0@10213000 {
		compatible = "mediatek,md2md_md2_ccif0";
		reg = <0x00 0x10213000 0x00 0x1000>;
	};

	sramrom@10214000 {
		compatible = "mediatek,sramrom";
		reg = <0x00 0x10214000 0x00 0x1000>;
	};

	mipi_tx0@11c80000 {
		compatible = "mediatek,mipi_tx0";
		reg = <0x00 0x11c80000 0x00 0x1000>;
	};

	mcdi@10216000 {
		compatible = "mediatek,mt6739-mcdi";
		reg = <0x00 0x10fc00 0x00 0x400 0x00 0x10216000 0x00 0x1000 0x00 0x10217000 0x00 0x2000>;
	};

	emi@10219000 {
		compatible = "mediatek,emi";
		reg = <0x00 0x10219000 0x00 0x1000 0x00 0x1021a000 0x00 0x1000 0x00 0x10226000 0x00 0x1000>;
		interrupts = <0x00 0x90 0x08 0x00 0x91 0x04 0x00 0x98 0x04>;
	};

	apcldmain@1021b000 {
		compatible = "mediatek,apcldmain";
		reg = <0x00 0x1021b000 0x00 0x00>;
	};

	apcldmain@1021b100 {
		compatible = "mediatek,apcldmain";
		reg = <0x00 0x1021b100 0x00 0x00>;
	};

	apcldmaout@1021b400 {
		compatible = "mediatek,apcldmaout";
		reg = <0x00 0x1021b400 0x00 0x00>;
	};

	apcldmaout@1021b500 {
		compatible = "mediatek,apcldmaout";
		reg = <0x00 0x1021b500 0x00 0x00>;
	};

	apcldmamisc@1021b800 {
		compatible = "mediatek,apcldmamisc";
		reg = <0x00 0x1021b800 0x00 0x00>;
		interrupts = <0x00 0xa5 0x04>;
	};

	apcldmamisc@1021b900 {
		compatible = "mediatek,apcldmamisc";
		reg = <0x00 0x1021b900 0x00 0x400>;
	};

	mdcldmain@1021c000 {
		compatible = "mediatek,mdcldmain";
		reg = <0x00 0x1021c000 0x00 0x400>;
	};

	mdcldmaout@1021c400 {
		compatible = "mediatek,mdcldmaout";
		reg = <0x00 0x1021c400 0x00 0x400>;
	};

	mdcldmamisc@1021c000 {
		compatible = "mediatek,mdcldmamisc";
		reg = <0x00 0x1021c000 0x00 0x00>;
	};

	mdcldmamisc@1021c900 {
		compatible = "mediatek,mdcldmamisc";
		reg = <0x00 0x1021c900 0x00 0x400>;
	};

	mdcldma@10014000 {
		compatible = "mediatek,mdcldma";
		reg = <0x00 0x10014000 0x00 0x1000 0x00 0x1021b000 0x00 0x1000 0x00 0x10209000 0x00 0x1000 0x00 0x1020a000 0x00 0x1000>;
		interrupts = <0x00 0xa5 0x04 0x00 0x94 0x08 0x00 0x95 0x08 0x00 0xe3 0x02>;
		mediatek,md_id = <0x00>;
		mediatek,cldma_capability = <0x06>;
		clocks = <0x1e 0x02 0x1d 0x34 0x1d 0x2b 0x1d 0x2e 0x1d 0x24 0x1d 0x25>;
		clock-names = "scp-sys-md1-main\0infra-cldma-bclk\0infra-ccif-ap\0infra-ccif-md\0infra-ccif1-ap\0infra-ccif1-md";
		phandle = <0x19>;
	};

	dramc_nao@1021d000 {
		compatible = "mediatek,dramc_nao";
		reg = <0x00 0x1021d000 0x00 0x1000>;
	};

	bpi_bsi_slv0@1021e000 {
		compatible = "mediatek,bpi_bsi_slv0";
		reg = <0x00 0x1021e000 0x00 0x1000>;
	};

	bpi_bsi_slv1@1021f000 {
		compatible = "mediatek,bpi_bsi_slv1";
		reg = <0x00 0x1021f000 0x00 0x6000>;
	};

	bpi_bsi_slv2@10225000 {
		compatible = "mediatek,bpi_bsi_slv2";
		reg = <0x00 0x10225000 0x00 0x1000>;
	};

	dvfsp@10227000 {
		compatible = "mediatek,dvfsp";
		reg = <0x00 0x10227000 0x00 0x1000>;
		interrupts = <0x00 0xa3 0x08>;
	};

	gce_mbox@10228000 {
		compatible = "mediatek,mailbox-gce";
		reg = <0x00 0x10228000 0x00 0x4000>;
		interrupts = <0x00 0x9a 0x08>;
		#mbox-cells = <0x03>;
		#gce-event-cells = <0x01>;
		#gce-subsys-cells = <0x02>;
		max_prefetch_cnt = <0x01>;
		prefetch_size = <0x60>;
		clocks = <0x1d 0x07 0x1d 0x18>;
		clock-names = "gce\0gce-timer";
		phandle = <0x28>;
	};

	gce@10228000 {
		compatible = "mediatek,gce";
		reg = <0x00 0x10228000 0x00 0x4000>;
		interrupts = <0x00 0x9a 0x08 0x00 0x9b 0x08>;
		g3d_config_base = <0x13000000 0x00 0xffff0000>;
		mmsys_config_base = <0x14000000 0x01 0xffff0000>;
		disp_dither_base = <0x14010000 0x02 0xffff0000>;
		mm_na_base = <0x14020000 0x03 0xffff0000>;
		imgsys_base = <0x15020000 0x04 0xffff0000>;
		vdec_gcon_base = <0x18800000 0x05 0xffff0000>;
		venc_gcon_base = <0x18810000 0x06 0xffff0000>;
		conn_peri_base = <0x18820000 0x07 0xffff0000>;
		topckgen_base = <0x18830000 0x08 0xffff0000>;
		kp_base = <0x18840000 0x09 0xffff0000>;
		scp_sram_base = <0x10000000 0x0a 0xffff0000>;
		infra_na3_base = <0x10010000 0x0b 0xffff0000>;
		infra_na4_base = <0x10020000 0x0c 0xffff0000>;
		scp_base = <0x10030000 0x0d 0xffff0000>;
		mcucfg_base = <0x10040000 0x0e 0xffff0000>;
		gcpu_base = <0x10050000 0x0f 0xffff0000>;
		usb0_base = <0x10200000 0x10 0xffff0000>;
		usb_sif_base = <0x10280000 0x11 0xffff0000>;
		audio_base = <0x17000000 0x12 0xffff0000>;
		vdec_base = <0x17010000 0x13 0xffff0000>;
		msdc2_base = <0x17020000 0x14 0xffff0000>;
		vdec1_base = <0x17030000 0x15 0xffff0000>;
		msdc3_base = <0x18000000 0x16 0xffff0000>;
		ap_dma_base = <0x18010000 0x17 0xffff0000>;
		gce_base = <0x18020000 0x18 0xffff0000>;
		vdec2_base = <0x18040000 0x19 0xffff0000>;
		vdec3_base = <0x18050000 0x1a 0xffff0000>;
		camsys_base = <0x18080000 0x1b 0xffff0000>;
		camsys1_base = <0x180a0000 0x1c 0xffff0000>;
		camsys2_base = <0x180b0000 0x1d 0xffff0000>;
		pwm_sw_base = <0x11000000 0x63 0xffff0000>;
		mdp_rdma0_sof = <0x00>;
		mdp_rsz0_sof = <0x01>;
		mdp_rsz1_sof = <0x02>;
		mdp_wdma_sof = <0x03>;
		mdp_wrot0_sof = <0x04>;
		mdp_tdshp_sof = <0x05>;
		disp_ovl0_sof = <0x06>;
		disp_rdma0_sof = <0x07>;
		disp_wdma0_sof = <0x08>;
		disp_color0_sof = <0x09>;
		disp_ccorr0_sof = <0x0a>;
		disp_aal0_sof = <0x0b>;
		disp_gamma0_sof = <0x0c>;
		disp_dither0_sof = <0x0d>;
		disp_dsi0_sof = <0x0e>;
		disp_dbi0_sof = <0x0f>;
		disp_pwm0_sof = <0x10>;
		disp_rdma0_frame_done = <0x11>;
		mdp_rdma0_frame_done = <0x12>;
		mdp_rsz0_frame_done = <0x13>;
		mdp_rsz1_frame_done = <0x14>;
		mdp_tdshp_frame_done = <0x15>;
		mdp_wrot0_write_frame_done = <0x16>;
		mdp_wdma_frame_done = <0x17>;
		disp_ovl0_frame_done = <0x18>;
		disp_wdma0_frame_done = <0x19>;
		disp_color0_frame_done = <0x1a>;
		disp_ccorr0_frame_done = <0x1b>;
		disp_aal0_frame_done = <0x1c>;
		disp_gamma0_frame_done = <0x1d>;
		disp_dither0_frame_done = <0x1e>;
		disp_dsi0_frame_done = <0x1f>;
		disp_dbi0_frame_done = <0x20>;
		stream_done_0 = <0x82>;
		stream_done_1 = <0x83>;
		stream_done_2 = <0x84>;
		stream_done_3 = <0x85>;
		stream_done_4 = <0x86>;
		stream_done_5 = <0x87>;
		stream_done_6 = <0x88>;
		stream_done_7 = <0x89>;
		stream_done_8 = <0x8a>;
		stream_done_9 = <0x8b>;
		buf_underrun_event_0 = <0x8c>;
		buf_underrun_event_1 = <0x8d>;
		dsi0_te_event = <0x8e>;
		dsi0_irq_event = <0x8f>;
		dsi0_done_event = <0x90>;
		disp_wdma0_rst_done = <0x94>;
		mdp_wdma_rst_done = <0x95>;
		mdp_wrot0_rst_done = <0x96>;
		mdp_rdma0_rst_done = <0x98>;
		disp_ovl0_frame_rst_done_pusle = <0x99>;
		isp_frame_done_p2_2 = <0x101>;
		isp_frame_done_p2_1 = <0x102>;
		isp_frame_done_p2_0 = <0x103>;
		isp_frame_done_p1_1 = <0x104>;
		isp_frame_done_p1_0 = <0x105>;
		camsv_2_pass1_done = <0x106>;
		camsv_1_pass1_done = <0x107>;
		seninf_cam1_2_3_fifo_full = <0x108>;
		seninf_cam0_fifo_full = <0x109>;
		venc_done = <0x121>;
		jpgenc_done = <0x122>;
		jpgdec_done = <0x123>;
		venc_mb_done = <0x124>;
		venc_128byte_cnt_done = <0x125>;
		max_prefetch_cnt = <0x01>;
		prefetch_size = <0x60>;
		sram_size_cpr_64 = <0x40>;
		mmsys_config = <0x1f>;
		mdp_rdma0 = <0x20>;
		mdp_rsz0 = <0x21>;
		mdp_rsz1 = <0x22>;
		mdp_wdma0 = <0x23>;
		mdp_wrot0 = <0x24>;
		mdp_tdshp0 = <0x25>;
		mm_mutex = <0x26>;
		disp_ovl0 = <0x27>;
		sram_share_cnt = <0x01>;
		sram_share_engine = <0x08>;
		sram_share_event = <0x2c6>;
		mediatek,mailbox-gce = <0x28>;
		mboxes = <0x28 0x00 0x00 0x04 0x28 0x01 0x00 0x04 0x28 0x02 0x00 0x05 0x28 0x03 0x00 0x04 0x28 0x04 0x00 0x04 0x28 0x05 0x00 0x04 0x28 0x06 0x00 0x04 0x28 0x07 0xffffffff 0x02 0x28 0x08 0x00 0x01 0x28 0x09 0x00 0x01 0x28 0x0a 0x00 0x01 0x28 0x0b 0x00 0x01 0x28 0x0c 0x00 0x01 0x28 0x0d 0x00 0x01 0x28 0x0e 0x00 0x01 0x28 0x0f 0x00 0x01>;
		clocks = <0x1d 0x07 0x1d 0x18>;
		clock-names = "GCE\0GCE_TIMER";
	};

	dramc_ch0_top0@10228000 {
		compatible = "mediatek,dramc_ch0_top0";
		reg = <0x00 0x10228000 0x00 0x2000>;
	};

	dramc_ch0_top1@1022a000 {
		compatible = "mediatek,dramc_ch0_top1";
		reg = <0x00 0x1022a000 0x00 0x2000>;
	};

	dramc_ch0_top2@1022c000 {
		compatible = "mediatek,dramc_ch0_top2";
		reg = <0x00 0x1022c000 0x00 0x1000>;
	};

	dramc_ch0_top3@1022d000 {
		compatible = "mediatek,dramc_ch0_top3";
		reg = <0x00 0x1022d000 0x00 0x1000>;
	};

	dramc_ch0_rsv@1022e000 {
		compatible = "mediatek,dramc_ch0_rsv";
		reg = <0x00 0x1022e000 0x00 0x2000>;
	};

	dramc_ch1_top0@10230000 {
		compatible = "mediatek,dramc_ch1_top0";
		reg = <0x00 0x10230000 0x00 0x2000>;
	};

	dramc_ch1_top1@10232000 {
		compatible = "mediatek,dramc_ch1_top1";
		reg = <0x00 0x10232000 0x00 0x2000>;
	};

	dramc_ch1_top2@10234000 {
		compatible = "mediatek,dramc_ch1_top2";
		reg = <0x00 0x10234000 0x00 0x1000>;
	};

	dramc_ch1_top3@10235000 {
		compatible = "mediatek,dramc_ch1_top3";
		reg = <0x00 0x10235000 0x00 0x1000>;
	};

	dramc_ch1_rsv@10236000 {
		compatible = "mediatek,dramc_ch1_rsv";
		reg = <0x00 0x10236000 0x00 0x2000>;
	};

	gic500@0c000000 {
		compatible = "mediatek,gic500";
		reg = <0x00 0xc000000 0x00 0x00>;
	};

	gic_cpu@0c400000 {
		compatible = "mediatek,gic_cpu";
		reg = <0x00 0xc400000 0x00 0x40000>;
	};

	dfd@0c600000 {
		compatible = "mediatek,dfd";
		reg = <0x00 0xc600000 0x00 0x00>;
	};

	dbg_etb@0d010000 {
		compatible = "mediatek,dbg_etb";
		reg = <0x00 0xd010000 0x00 0x10000>;
	};

	dbg_cti@0d020000 {
		compatible = "mediatek,dbg_cti";
		reg = <0x00 0xd020000 0x00 0x10000>;
	};

	dbg_etr@0d030000 {
		compatible = "mediatek,dbg_etr";
		reg = <0x00 0xd030000 0x00 0x10000>;
	};

	dbg_funnel@0d040000 {
		compatible = "mediatek,dbg_funnel";
		reg = <0x00 0xd040000 0x00 0x10000>;
	};

	dbg_dem@0d0a0000 {
		compatible = "mediatek,dbg_dem";
		reg = <0x00 0xd0a0000 0x00 0x10000>;
		interrupts = <0x00 0x8c 0x08>;
	};

	dbg_mdsys1@0d0c0000 {
		compatible = "mediatek,dbg_mdsys1";
		reg = <0x00 0xd0c0000 0x00 0x40000>;
	};

	dbg_apmcu_mp0@0d400000 {
		compatible = "mediatek,dbg_apmcu_mp0";
		reg = <0x00 0xd400000 0x00 0x1000>;
	};

	dbg_apmcu_mp0@0d410000 {
		compatible = "mediatek,dbg_apmcu_mp0";
		reg = <0x00 0xd410000 0x00 0x1000>;
	};

	dbg_apmcu_mp0@0d420000 {
		compatible = "mediatek,dbg_apmcu_mp0";
		reg = <0x00 0xd420000 0x00 0x1000>;
	};

	dbg_apmcu_mp0@0d430000 {
		compatible = "mediatek,dbg_apmcu_mp0";
		reg = <0x00 0xd430000 0x00 0x1000>;
	};

	dbg_apmcu_mp0@0d440000 {
		compatible = "mediatek,dbg_apmcu_mp0";
		reg = <0x00 0xd440000 0x00 0x1000>;
	};

	dbg_apmcu_mp0@0d510000 {
		compatible = "mediatek,dbg_apmcu_mp0";
		reg = <0x00 0xd510000 0x00 0x1000>;
	};

	dbg_apmcu_mp0@0d520000 {
		compatible = "mediatek,dbg_apmcu_mp0";
		reg = <0x00 0xd520000 0x00 0x1000>;
	};

	dbg_apmcu_mp0@0d530000 {
		compatible = "mediatek,dbg_apmcu_mp0";
		reg = <0x00 0xd530000 0x00 0x1000>;
	};

	dbg_apmcu_mp0@0d540000 {
		compatible = "mediatek,dbg_apmcu_mp0";
		reg = <0x00 0xd540000 0x00 0x1000>;
	};

	dbg_apmcu_mp0@0d610000 {
		compatible = "mediatek,dbg_apmcu_mp0";
		reg = <0x00 0xd610000 0x00 0x1000>;
	};

	dbg_apmcu_mp0@0d620000 {
		compatible = "mediatek,dbg_apmcu_mp0";
		reg = <0x00 0xd620000 0x00 0x1000>;
	};

	dbg_apmcu_mp0@0d630000 {
		compatible = "mediatek,dbg_apmcu_mp0";
		reg = <0x00 0xd630000 0x00 0x1000>;
	};

	dbg_apmcu_mp0@0d640000 {
		compatible = "mediatek,dbg_apmcu_mp0";
		reg = <0x00 0xd640000 0x00 0x1000>;
	};

	dbg_apmcu_mp0@0d710000 {
		compatible = "mediatek,dbg_apmcu_mp0";
		reg = <0x00 0xd710000 0x00 0x1000>;
	};

	dbg_apmcu_mp0@0d720000 {
		compatible = "mediatek,dbg_apmcu_mp0";
		reg = <0x00 0xd720000 0x00 0x1000>;
	};

	dbg_apmcu_mp0@0d730000 {
		compatible = "mediatek,dbg_apmcu_mp0";
		reg = <0x00 0xd730000 0x00 0x1000>;
	};

	dbg_apmcu_mp0@0d740000 {
		compatible = "mediatek,dbg_apmcu_mp0";
		reg = <0x00 0xd740000 0x00 0x1000>;
	};

	dbg_apmcu_mp1@0d800000 {
		compatible = "mediatek,dbg_apmcu_mp1";
		reg = <0x00 0xd800000 0x00 0x00>;
	};

	ap_dma@11000000 {
		compatible = "mediatek,ap_dma";
		reg = <0x00 0x11000000 0x00 0x1000>;
		interrupts = <0x00 0x52 0x08>;
	};

	auxadc@11001000 {
		compatible = "mediatek,auxadc";
		reg = <0x00 0x11001000 0x00 0x1000>;
		interrupts = <0x00 0x4a 0x02>;
		clocks = <0x1d 0x22>;
		clock-names = "auxadc-main";
		phandle = <0x6c>;
	};

	apuart0@11002000 {
		cell-index = <0x00>;
		compatible = "mediatek,mtk-uart";
		reg = <0x00 0x11002000 0x00 0x1000 0x00 0x11000400 0x00 0x80 0x00 0x11000480 0x00 0x80>;
		interrupts = <0x00 0x5b 0x08 0x00 0x68 0x08 0x00 0x69 0x08>;
		clock-frequency = <0x18cba80>;
		clock-div = <0x01>;
		clocks = <0x1d 0x14 0x1d 0x28>;
		clock-names = "uart0-main\0uart-apdma";
		phandle = <0x6d>;
	};

	apuart1@11003000 {
		cell-index = <0x01>;
		compatible = "mediatek,mtk-uart";
		reg = <0x00 0x11003000 0x00 0x1000 0x00 0x11000500 0x00 0x80 0x00 0x11000580 0x00 0x80>;
		interrupts = <0x00 0x5c 0x08 0x00 0x6a 0x08 0x00 0x6b 0x08>;
		clock-frequency = <0x18cba80>;
		clock-div = <0x01>;
		clocks = <0x1d 0x15>;
		clock-names = "uart1-main";
		phandle = <0x6e>;
	};

	pwm@11006000 {
		compatible = "mediatek,pwm";
		reg = <0x00 0x11006000 0x00 0x1000>;
		interrupts = <0x00 0x4d 0x08>;
		clocks = <0x1d 0x0e 0x1d 0x0f 0x1d 0x10 0x1d 0x11 0x1d 0x12 0x1d 0x32 0x1d 0x0d 0x1d 0x13>;
		clock-names = "PWM1-main\0PWM2-main\0PWM3-main\0PWM4-main\0PWM5-main\0PWM6-main\0PWM-HCLK-main\0PWM-main";
	};

	i2c_common {
		compatible = "mediatek,i2c_common";
		dma_support = [01];
		idvfs = [00];
		set_dt_div = [01];
		check_max_freq = [01];
		set_ltiming = [01];
		set_aed = [01];
		ext_time_config = [18 01];
		phandle = <0x6f>;
	};

	i2c@11007000 {
		compatible = "mediatek,i2c";
		id = <0x00>;
		reg = <0x00 0x11007000 0x00 0x1000 0x00 0x11000100 0x00 0x80>;
		interrupts = <0x00 0x54 0x08>;
		clocks = <0x1d 0x09 0x1d 0x28>;
		clock-names = "main\0dma";
		clock-div = <0x05>;
		aed = <0x1f>;
		phandle = <0x70>;
	};

	i2c@11008000 {
		compatible = "mediatek,i2c";
		id = <0x01>;
		reg = <0x00 0x11008000 0x00 0x1000 0x00 0x11000180 0x00 0x80>;
		interrupts = <0x00 0x55 0x08>;
		clocks = <0x1d 0x0a 0x1d 0x28>;
		clock-names = "main\0dma";
		clock-div = <0x05>;
		aed = <0x1f>;
		phandle = <0x71>;
	};

	i2c@11009000 {
		compatible = "mediatek,i2c";
		id = <0x02>;
		reg = <0x00 0x11009000 0x00 0x1000 0x00 0x11000200 0x00 0x80>;
		interrupts = <0x00 0x56 0x08>;
		clocks = <0x1d 0x0b 0x1d 0x28>;
		clock-names = "main\0dma";
		clock-div = <0x05>;
		aed = <0x1f>;
		phandle = <0x72>;
	};

	i2c@1100f000 {
		compatible = "mediatek,i2c";
		id = <0x03>;
		reg = <0x00 0x1100f000 0x00 0x1000 0x00 0x11000280 0x00 0x80>;
		interrupts = <0x00 0x57 0x08>;
		clocks = <0x1d 0x0c 0x1d 0x28>;
		clock-names = "main\0dma";
		clock-div = <0x05>;
		aed = <0x1f>;
		phandle = <0x73>;
	};

	i2c@11011000 {
		compatible = "mediatek,i2c";
		id = <0x04>;
		reg = <0x00 0x11011000 0x00 0x1000 0x00 0x11000300 0x00 0x80>;
		interrupts = <0x00 0x58 0x08>;
		clocks = <0x1d 0x37 0x1d 0x28>;
		clock-names = "main\0dma";
		clock-div = <0x05>;
		aed = <0x1f>;
		phandle = <0x74>;
	};

	i2c@11016000 {
		compatible = "mediatek,i2c";
		id = <0x05>;
		reg = <0x00 0x11016000 0x00 0x1000 0x00 0x11000380 0x00 0x80>;
		interrupts = <0x00 0x82 0x08>;
		clocks = <0x1d 0x3b 0x1d 0x28>;
		clock-names = "main\0dma";
		clock-div = <0x05>;
		aed = <0x1f>;
		phandle = <0x75>;
	};

	spi@1100a000 {
		compatible = "mediatek,mt6739-spi";
		mediatek,pad-select = <0x00>;
		reg = <0x00 0x1100a000 0x00 0x1000>;
		interrupts = <0x00 0x76 0x08>;
		clocks = <0x29 0x0a 0x29 0x30 0x1d 0x1b>;
		clock-names = "parent-clk\0sel-clk\0spi-clk";
		phandle = <0x76>;
	};

	spi@11010000 {
		compatible = "mediatek,mt6739-spi";
		mediatek,pad-select = <0x00>;
		reg = <0x00 0x11010000 0x00 0x1000>;
		interrupts = <0x00 0x7a 0x08>;
		clocks = <0x29 0x0a 0x29 0x30 0x1d 0x36>;
		clock-names = "parent-clk\0sel-clk\0spi-clk";
		phandle = <0x77>;
	};

	spi@11012000 {
		compatible = "mediatek,mt6739-spi";
		mediatek,pad-select = <0x00>;
		reg = <0x00 0x11012000 0x00 0x1000>;
		interrupts = <0x00 0x80 0x08>;
		clocks = <0x29 0x0a 0x29 0x30 0x1d 0x39>;
		clock-names = "parent-clk\0sel-clk\0spi-clk";
		phandle = <0x78>;
	};

	therm_ctrl@1100b000 {
		compatible = "mediatek,therm_ctrl";
		reg = <0x00 0x1100b000 0x00 0x1000>;
		interrupts = <0x00 0x4e 0x08>;
		clocks = <0x1d 0x08>;
		clock-names = "therm-main";
	};

	eem_fsm@1100b000 {
		compatible = "mediatek,eem_fsm";
		reg = <0x00 0x1100b000 0x00 0x1000>;
		interrupts = <0x00 0x7d 0x08>;
		clocks = <0x29 0x2d 0x29 0x00 0x29 0x20 0x1e 0x00 0x1e 0x01>;
		clock-names = "CLK_TOP_MFG\0CLK_TOP_MFG_OFF\0CLK_TOP_MFG_ON\0CG_SCP_SYS_MFG0\0CG_SCP_SYS_MFG1";
	};

	btif@1100c000 {
		compatible = "mediatek,btif";
		#address-cells = <0x02>;
		#size-cells = <0x02>;
		reg = <0x00 0x1100c000 0x00 0x1000 0x00 0x11000600 0x00 0x80 0x00 0x11000680 0x00 0x80>;
		interrupts = <0x00 0x70 0x08 0x00 0x6c 0x08 0x00 0x6d 0x08>;
		clocks = <0x1d 0x1a 0x1d 0x28>;
		clock-names = "btifc\0apdmac";
	};

	irtx@1100d000 {
		compatible = "mediatek,irtx";
		reg = <0x00 0x1100d000 0x00 0x1000>;
		interrupts = <0x00 0x7f 0x08>;
	};

	disp_pwm0@1100e000 {
		compatible = "mediatek,disp_pwm0";
		reg = <0x00 0x1100e000 0x00 0x1000>;
	};

	spi2@11010000 {
		compatible = "mediatek,spi2";
		reg = <0x00 0x11010000 0x00 0x1000>;
		interrupts = <0x00 0x80 0x08>;
	};

	spi3@11012000 {
		compatible = "mediatek,spi3";
		reg = <0x00 0x11012000 0x00 0x00>;
		interrupts = <0x00 0x81 0x08>;
	};

	spi4@11013000 {
		compatible = "mediatek,spi4";
		reg = <0x00 0x11013000 0x00 0x1000>;
	};

	nfi@11018000 {
		compatible = "mediatek,nfi";
		reg = <0x00 0x11018000 0x00 0x1000>;
		interrupts = <0x00 0x86 0x08>;
		clocks = <0x29 0x3a 0x29 0x3b 0x1b 0x29 0x07 0x29 0x0c 0x29 0x06 0x29 0x08 0x29 0x23 0x29 0x15 0x29 0x1c 0x29 0x0d 0x29 0x19 0x29 0x02 0x29 0x18 0x29 0x09 0x1d 0x1e 0x1d 0x27 0x1d 0x4f>;
		clock-names = "nfi2x_sel\0nfiecc_sel\0clk26m\0syspll2_d2\0syspll_d7\0syspll_d3\0syspll2_d4\0msdcpll_d2\0univpll1_d2\0univpll_d5\0syspll4_d2\0univpll2_d4\0syspll1_d2\0univpll2_d2\0syspll_d5\0infra_nfiecc\0infra_nfi\0infra_nfi_1x";
	};

	nfiecc@11019000 {
		compatible = "mediatek,nfiecc";
		reg = <0x00 0x11019000 0x00 0x1000>;
		interrupts = <0x00 0x87 0x08>;
	};

	msdc@11230000 {
		compatible = "mediatek,msdc";
		reg = <0x00 0x11230000 0x00 0x10000 0x00 0x11cd0000 0x00 0x10000>;
		interrupts = <0x00 0x4f 0x08>;
		index = [00];
		clk_src = [01];
		bus-width = <0x08>;
		max-frequency = <0xbebc200>;
		cap-mmc-highspeed;
		msdc-sys-suspend;
		mmc-ddr-1_8v;
		mmc-hs200-1_8v;
		mmc-hs400-1_8v;
		non-removable;
		pinctl = <0x2a>;
		pinctl_hs400 = <0x2a>;
		pinctl_hs200 = <0x2a>;
		register_setting = <0x2b>;
		host_function = [00];
		status = "okay";
		vmmc-supply = <0x2c>;
		clocks = <0x1d 0x4b 0x1d 0x1c>;
		clock-names = "msdc0-clock\0msdc0-hclock";
		hw_dvfs = [00];
		phandle = <0x79>;

		msdc0@default {
			phandle = <0x2a>;

			pins_cmd {
				drive-strength = [04];
			};

			pins_dat {
				drive-strength = [04];
			};

			pins_clk {
				drive-strength = [04];
			};

			pins_rst {
				drive-strength = [04];
			};

			pins_ds {
				drive-strength = [04];
			};
		};

		msdc0@register_default {
			cmd_edge = [00];
			rdata_edge = [00];
			wdata_edge = [00];
			phandle = <0x2b>;
		};
	};

	msdc@11240000 {
		compatible = "mediatek,msdc";
		reg = <0x00 0x11240000 0x00 0x10000 0x00 0x11c40000 0x00 0x10000>;
		interrupts = <0x00 0x50 0x08>;
		index = [01];
		clk_src = [02];
		bus-width = <0x04>;
		max-frequency = <0xbebc200>;
		msdc-sys-suspend;
		cap-sd-highspeed;
		sd-uhs-sdr12;
		sd-uhs-sdr25;
		sd-uhs-sdr50;
		sd-uhs-sdr104;
		sd-uhs-ddr50;
		pinctl = <0x2d>;
		pinctl_sdr104 = <0x2e>;
		pinctl_sdr50 = <0x2f>;
		pinctl_ddr50 = <0x30>;
		register_setting = <0x31>;
		host_function = [01];
		cd_level = [01];
		cd-gpios = <0x17 0x0f 0x00>;
		status = "okay";
		vmmc-supply = <0x32>;
		vqmmc-supply = <0x33>;
		clocks = <0x1d 0x4c 0x1d 0x1d>;
		clock-names = "msdc1-clock\0msdc1-hclock";
		hw_dvfs = [00];
		phandle = <0x7a>;

		msdc1@default {
			phandle = <0x2d>;

			pins_cmd {
				drive-strength = [03];
			};

			pins_dat {
				drive-strength = [03];
			};

			pins_clk {
				drive-strength = [03];
			};
		};

		msdc1@sdr104 {
			phandle = <0x2e>;

			pins_cmd {
				drive-strength = [03];
			};

			pins_dat {
				drive-strength = [03];
			};

			pins_clk {
				drive-strength = [03];
			};
		};

		msdc1@sdr50 {
			phandle = <0x2f>;

			pins_cmd {
				drive-strength = [03];
			};

			pins_dat {
				drive-strength = [03];
			};

			pins_clk {
				drive-strength = [03];
			};
		};

		msdc1@ddr50 {
			phandle = <0x30>;

			pins_cmd {
				drive-strength = [03];
			};

			pins_dat {
				drive-strength = [03];
			};

			pins_clk {
				drive-strength = [03];
			};
		};

		msdc1@register_default {
			cmd_edge = [00];
			rdata_edge = [00];
			wdata_edge = [00];
			phandle = <0x31>;
		};
	};

	usb0@11200000 {
		compatible = "mediatek,mt6739-usb20";
		reg = <0x00 0x11200000 0x00 0x10000 0x00 0x11cc0000 0x00 0x10000>;
		interrupts = <0x00 0x49 0x08>;
		mode = <0x02>;
		multipoint = <0x01>;
		num_eps = <0x10>;
		clocks = <0x1d 0x06 0x29 0x3c 0x29 0x1e>;
		clock-names = "usb0\0usb0_clk_top_sel\0usb0_clk_univpll3_d4";
	};

	audio@11220000 {
		compatible = "mediatek,audio\0syscon";
		reg = <0x00 0x11220000 0x00 0x1000>;
		#clock-cells = <0x01>;
		mediatek,btcvsd_snd = <0x34>;
		phandle = <0x35>;
	};

	mt_soc_dl1_pcm@11220000 {
		compatible = "mediatek,mt_soc_pcm_dl1";
		reg = <0x00 0x11220000 0x00 0x1000>;
		interrupts = <0x00 0x99 0x08>;
		clocks = <0x35 0x00 0x35 0x04 0x35 0x05 0x35 0x03 0x35 0x01 0x35 0x02 0x35 0x06 0x1d 0x2d 0x1d 0x35 0x29 0x34 0x29 0x35 0x29 0x03 0x29 0x38 0x29 0x24 0x29 0x42 0x29 0x27 0x36 0x06 0x1b>;
		clock-names = "aud_afe_clk\0aud_dac_clk\0aud_dac_predis_clk\0aud_adc_clk\0aud_apll22m_clk\0aud_apll1_tuner_clk\0aud_tml_clk\0aud_infra_clk\0mtkaif_26m_clk\0top_mux_audio\0top_mux_audio_int\0top_sys_pll1_d4\0top_mux_aud_1\0top_apll1_ck\0top_mux_aud_eng1\0top_apll1_d8\0apmixed_apll1\0top_clk26m_clk";
		phandle = <0x7b>;
	};

	audio_sram@11221000 {
		compatible = "mediatek,audio_sram";
		reg = <0x00 0x11221000 0x00 0x9000>;
	};

	mtk-btcvsd-snd@18000000 {
		compatible = "mediatek,mtk-btcvsd-snd";
		reg = <0x00 0x18000000 0x00 0x10000 0x00 0x18080000 0x00 0x8000>;
		interrupts = <0x00 0xe8 0x08>;
		mediatek,infracfg = <0x1d>;
		mediatek,offset = <0xf00 0x800 0xfd0 0xfd4 0xfd8>;
		phandle = <0x34>;
	};

	mt_soc_deep_buffer_dl_pcm {
		compatible = "mediatek,mt_soc_pcm_deep_buffer_dl";
	};

	mt_soc_ul1_pcm {
		compatible = "mediatek,mt_soc_pcm_capture";
	};

	mt_soc_voice_md1 {
		compatible = "mediatek,mt_soc_pcm_voice_md1";
	};

	mt_soc_hdmi_pcm {
		compatible = "mediatek,mt_soc_pcm_hdmi";
	};

	mt_soc_uldlloopback_pcm {
		compatible = "mediatek,mt_soc_pcm_uldlloopback";
	};

	mt_soc_i2s0_pcm {
		compatible = "mediatek,mt_soc_pcm_dl1_i2s0";
	};

	mt_soc_mrgrx_pcm {
		compatible = "mediatek,mt_soc_pcm_mrgrx";
	};

	mt_soc_mrgrx_awb_pcm {
		compatible = "mediatek,mt_soc_pcm_mrgrx_awb";
	};

	mt_soc_fm_i2s_pcm {
		compatible = "mediatek,mt_soc_pcm_fm_i2s";
	};

	mt_soc_fm_i2s_awb_pcm {
		compatible = "mediatek,mt_soc_pcm_fm_i2s_awb";
	};

	mt_soc_i2s0dl1_pcm {
		compatible = "mediatek,mt_soc_pcm_dl1_i2s0dl1";
	};

	mt_soc_dl1_awb_pcm {
		compatible = "mediatek,mt_soc_pcm_dl1_awb";
	};

	mt_soc_voice_md1_bt {
		compatible = "mediatek,mt_soc_pcm_voice_md1_bt";
	};

	mt_soc_voip_bt_out {
		compatible = "mediatek,mt_soc_pcm_dl1_bt";
	};

	mt_soc_voip_bt_in {
		compatible = "mediatek,mt_soc_pcm_bt_dai";
	};

	mt_soc_tdmrx_pcm {
		compatible = "mediatek,mt_soc_tdm_capture";
	};

	mt_soc_fm_mrgtx_pcm {
		compatible = "mediatek,mt_soc_pcm_fmtx";
	};

	mt_soc_ul2_pcm {
		compatible = "mediatek,mt_soc_pcm_capture2";
	};

	mt_soc_i2s0_awb_pcm {
		compatible = "mediatek,mt_soc_pcm_i2s0_awb";
	};

	mt_soc_voice_md2 {
		compatible = "mediatek,mt_soc_pcm_voice_md2";
	};

	mt_soc_routing_pcm {
		compatible = "mediatek,mt_soc_pcm_routing";
	};

	mt_soc_voice_md2_bt {
		compatible = "mediatek,mt_soc_pcm_voice_md2_bt";
	};

	mt_soc_hp_impedance_pcm {
		compatible = "mediatek,mt_soc_pcm_hp_impedance";
	};

	mt_soc_codec_name {
		compatible = "mediatek,mt_soc_codec_63xx";
		use_hp_depop_flow = <0x00>;
		use_ul_260k = <0x00>;
	};

	mt_soc_dummy_pcm {
		compatible = "mediatek,mt_soc_pcm_dummy";
	};

	mt_soc_codec_dummy_name {
		compatible = "mediatek,mt_soc_codec_dummy";
	};

	mt_soc_routing_dai_name {
		compatible = "mediatek,mt_soc_dai_routing";
	};

	mt_soc_dai_name {
		compatible = "mediatek,mt_soc_dai_stub";
	};

	mt_soc_dl2_pcm {
		compatible = "mediatek,mt_soc_pcm_dl2";
	};

	mt_soc_anc_pcm {
		compatible = "mediatek,mt_soc_pcm_anc";
	};

	mt_soc_pcm_voice_ultra {
		compatible = "mediatek,mt_soc_pcm_voice_ultra";
	};

	mt_soc_pcm_voice_usb {
		compatible = "mediatek,mt_soc_pcm_voice_usb";
	};

	mt_soc_pcm_voice_usb_echoref {
		compatible = "mediatek,mt_soc_pcm_voice_usb_echoref";
	};

	wifi@180f0000 {
		compatible = "mediatek,wifi";
		reg = <0x00 0x180f0000 0x00 0x5c>;
		interrupts = <0x00 0xea 0x08>;
		dma_addrmask = <0x24>;
		clocks = <0x1d 0x28>;
		clock-names = "wifi-dma";
	};

	efusec@11c00000 {
		compatible = "mediatek,efusec";
		reg = <0x00 0x11c00000 0x00 0x10000>;
	};

	mipi_rx_ana_csi0@11c10000 {
		compatible = "mediatek,mipi_rx_ana_csi0";
		reg = <0x00 0x11c10000 0x00 0x10000>;
	};

	mipi_rx_ana_csi1@11c20000 {
		compatible = "mediatek,mipi_rx_ana_csi1";
		reg = <0x00 0x11c20000 0x00 0x10000>;
	};

	msdc1_pad_macro@11c40000 {
		compatible = "mediatek,msdc1_pad_macro";
		reg = <0x00 0x11c40000 0x00 0x10000>;
	};

	msdc0_pad_macro@11cd0000 {
		compatible = "mediatek,msdc0_pad_macro";
		reg = <0x00 0x11cd0000 0x00 0x10000>;
	};

	mfg_auckland@13000000 {
		compatible = "mediatek,AUCKLAND";
		reg = <0x00 0x13000000 0x00 0x80000>;
		interrupts = <0x00 0xe2 0x08>;
		interrupt-names = "RGX";
		clock-frequency = <0x21f98280>;
		clocks = <0x29 0x2d 0x1b 0x29 0x20 0x1e 0x00 0x1e 0x01>;
		clock-names = "CLK_TOP_MFG\0CLK_TOP_MFG_OFF\0CLK_TOP_MFG_ON\0CG_SCP_SYS_MFG0\0CG_SCP_SYS_MFG1";
	};

	mfg_cfg@13ffe000 {
		compatible = "mediatek,mt6739-mfg_cfg\0syscon";
		reg = <0x00 0x13ffe000 0x00 0x1000>;
	};

	gpufreq {
		compatible = "mediatek,mt6739-gpufreq";
		clocks = <0x29 0x2d 0x1b 0x29 0x20>;
		clock-names = "CLK_TOP_MFG\0CLK_TOP_MFG_OFF\0CLK_TOP_MFG_ON";
	};

	mmsys_config@14000000 {
		compatible = "mediatek,mmsys_config\0syscon";
		reg = <0x00 0x14000000 0x00 0x1000>;
		interrupts = <0x00 0xd3 0x08>;
		#clock-cells = <0x01>;
		clocks = <0x1f 0x04>;
		clock-names = "CAM_MDP";
		phandle = <0x1f>;
	};

	touch {
		compatible = "mediatek,touch";
		phandle = <0x7c>;
	};

	flashlight_core {
		compatible = "mediatek,flashlight_core";
		phandle = <0x7d>;
	};

	flashlights_rt4505 {
		compatible = "mediatek,flashlights_rt4505";
		phandle = <0x7e>;
	};

	flashlights_aw3641 {
		compatible = "mediatek,flashlights_aw3641";
		decouple = <0x01>;
		phandle = <0x7f>;
	};

	mtkfb {
		compatible = "mediatek,mtkfb";
		phandle = <0x80>;
	};

	disp_mutex@14001000 {
		compatible = "mediatek,disp_mutex";
		reg = <0x00 0x14001000 0x00 0x1000>;
		interrupts = <0x00 0xc2 0x08>;
		phandle = <0x26>;
	};

	smi_common@14002000 {
		compatible = "mediatek,smi_common";
		reg = <0x00 0x14002000 0x00 0x1000>;
		larbs = <0x37 0x38 0x39>;
		clocks = <0x1e 0x04 0x1f 0x02 0x1f 0x03 0x1f 0x00 0x29 0x2c 0x29 0x21 0x29 0x07>;
		clock-names = "mtcmos-mm\0smi-common-gals0\0smi-common-gals1\0smi-common\0MMDVFS_CLK_TOP_MMPLL_CK\0mmdvfs_clk_top_vencpll_ck\0mmdvfs_clk_top_syspll2_d2";
		mediatek,smi-id = <0x03>;
		mmsys_config = <0x1f>;
	};

	smi_larb0@14003000 {
		compatible = "mediatek,smi_larb0\0mediatek,smi_larb";
		reg = <0x00 0x14003000 0x00 0x1000>;
		interrupts = <0x00 0xdf 0x08>;
		clocks = <0x1e 0x04 0x1f 0x01>;
		clock-names = "mtcmos-mm\0mm-larb0";
		mediatek,smi-id = <0x00>;
		phandle = <0x37>;
	};

	mdp_rdma0@14004000 {
		compatible = "mediatek,mdp_rdma0";
		reg = <0x00 0x14004000 0x00 0x1000>;
		interrupts = <0x00 0xc3 0x08>;
		clocks = <0x1f 0x05>;
		clock-names = "MDP_RDMA0";
		phandle = <0x20>;
	};

	mdp_rsz0@14005000 {
		compatible = "mediatek,mdp_rsz0";
		reg = <0x00 0x14005000 0x00 0x1000>;
		interrupts = <0x00 0xc4 0x08>;
		clocks = <0x1f 0x06>;
		clock-names = "MDP_RSZ0";
		phandle = <0x21>;
	};

	mdp_rsz1@14006000 {
		compatible = "mediatek,mdp_rsz1";
		reg = <0x00 0x14006000 0x00 0x1000>;
		interrupts = <0x00 0xc5 0x08>;
		clocks = <0x1f 0x07>;
		clock-names = "MDP_RSZ1";
		phandle = <0x22>;
	};

	mdp_wdma0@14007000 {
		compatible = "mediatek,mdp_wdma0";
		reg = <0x00 0x14007000 0x00 0x1000>;
		interrupts = <0x00 0xc8 0x08>;
		clocks = <0x1f 0x0a>;
		clock-names = "MDP_WDMA";
		phandle = <0x23>;
	};

	mdp_wrot0@14008000 {
		compatible = "mediatek,mdp_wrot0";
		reg = <0x00 0x14008000 0x00 0x1000>;
		interrupts = <0x00 0xc7 0x08>;
		clocks = <0x1f 0x09>;
		clock-names = "MDP_WROT0";
		phandle = <0x24>;
	};

	mdp_tdshp0@14009000 {
		compatible = "mediatek,mdp_tdshp0";
		reg = <0x00 0x14009000 0x00 0x1000>;
		clocks = <0x1f 0x08>;
		clock-names = "MDP_TDSHP";
		phandle = <0x25>;
	};

	disp_ovl0@1400a000 {
		compatible = "mediatek,disp_ovl0";
		reg = <0x00 0x1400a000 0x00 0x1000>;
		interrupts = <0x00 0xc9 0x08>;
		clocks = <0x1f 0x0c>;
		clock-names = "DISP_OVL0";
		phandle = <0x27>;
	};

	disp_rdma0@1400b000 {
		compatible = "mediatek,disp_rdma0";
		reg = <0x00 0x1400b000 0x00 0x1000>;
		interrupts = <0x00 0xca 0x08>;
	};

	disp_wdma0@1400c000 {
		compatible = "mediatek,disp_wdma0";
		reg = <0x00 0x1400c000 0x00 0x1000>;
		interrupts = <0x00 0xcb 0x08>;
	};

	disp_color0@1400d000 {
		compatible = "mediatek,disp_color0";
		reg = <0x00 0x1400d000 0x00 0x1000>;
		interrupts = <0x00 0xcc 0x08>;
	};

	disp_ccorr0@1400e000 {
		compatible = "mediatek,disp_ccorr0";
		reg = <0x00 0x1400e000 0x00 0x1000>;
		interrupts = <0x00 0xcd 0x08>;
	};

	disp_aal0@1400f000 {
		compatible = "mediatek,disp_aal0";
		reg = <0x00 0x1400f000 0x00 0x1000>;
		interrupts = <0x00 0xce 0x08>;
		aal_support = <0x01>;
		phandle = <0x81>;
	};

	disp_gamma0@14010000 {
		compatible = "mediatek,disp_gamma0";
		reg = <0x00 0x14010000 0x00 0x1000>;
		interrupts = <0x00 0xcf 0x08>;
	};

	disp_dither0@14011000 {
		compatible = "mediatek,disp_dither0";
		reg = <0x00 0x14011000 0x00 0x1000>;
		interrupts = <0x00 0xd0 0x08>;
	};

	dsi0@14012000 {
		compatible = "mediatek,dsi0";
		reg = <0x00 0x14012000 0x00 0x1000>;
		interrupts = <0x00 0xd1 0x08>;
	};

	dispsys@14000000 {
		compatible = "mediatek,dispsys";
		clocks = <0x1e 0x04 0x1f 0x00 0x1f 0x01 0x1f 0x02 0x1f 0x03 0x1f 0x0c 0x1f 0x0d 0x1f 0x0e 0x1f 0x0f 0x1f 0x10 0x1f 0x11 0x1f 0x12 0x1f 0x13 0x1f 0x14 0x1f 0x15 0x1f 0x18 0x1f 0x09 0x1d 0x33 0x29 0x39 0x1b 0x29 0x19 0x29 0x1a 0x29 0x1f>;
		clock-names = "CLK_MM_MTCMOS\0CLK_MM_SMI_COMMON\0CLK_MM_SMI_LARB0\0CLK_MM_GALS_COMM0\0CLK_MM_GALS_COMM1\0CLK_MM_DISP_OVL0\0CLK_MM_DISP_RDMA0\0CLK_MM_DISP_WDMA0\0CLK_MM_DISP_COLOR0\0CLK_MM_DISP_CCORR0\0CLK_MM_DISP_AAL0\0CLK_MM_DISP_GAMMA0\0CLK_MM_DISP_DITHER0\0CLK_MM_DSI_MM_CLOCK\0CLK_MM_DSI_INTERF\0CLK_MM_F26M_HRT\0MDP_WROT0\0DISP_PWM\0MUX_PWM\0CLK26M\0UNIVPLL2_D4\0UNIVPLL2_D8\0UNIVPLL3_D8";
		phandle = <0x82>;
	};

	dbi0@14013000 {
		compatible = "mediatek,dbi0";
		reg = <0x00 0x14013000 0x00 0x1000>;
		interrupts = <0x00 0xd2 0x08>;
	};

	mm_mutex@14016000 {
		compatible = "mediatek,mm_mutex";
		reg = <0x00 0x14016000 0x00 0x00>;
		phandle = <0x83>;
	};

	imgsys_config@15000000 {
		compatible = "mediatek,imgsys\0syscon";
		reg = <0x00 0x15000000 0x00 0x1000>;
		#clock-cells = <0x01>;
		phandle = <0x3a>;
	};

	ispsys@15000000 {
		compatible = "mediatek,mt6739-ispsys";
		reg = <0x00 0x15004000 0x00 0x9000 0x00 0x1500d000 0x00 0x1000 0x00 0x15000000 0x00 0x10000 0x00 0x10215000 0x00 0x3000 0x00 0x10211000 0x00 0x1000>;
		interrupts = <0x00 0xd9 0x08 0x00 0xda 0x08 0x00 0xdb 0x08 0x00 0xdc 0x08 0x00 0xdd 0x08>;
		clocks = <0x1e 0x04 0x1e 0x05 0x3a 0x01 0x3a 0x02 0x3a 0x03 0x3a 0x04 0x3a 0x05>;
		clock-names = "CG_SCP_SYS_MM0\0CG_SCP_SYS_ISP\0CG_IMG_CAM_SMI\0CG_IMG_CAM_CAM\0CG_IMG_SEN_TG\0CG_IMG_SEN_CAM\0CG_IMG_CAM_SV";
	};

	smi_larb2@15001000 {
		compatible = "mediatek,smi_larb2\0mediatek,smi_larb";
		reg = <0x00 0x15001000 0x00 0x1000>;
		interrupts = <0x00 0xde 0x08>;
		clocks = <0x1e 0x05 0x3a 0x00>;
		clock-names = "mtcmos-img\0img-larb2";
		mediatek,smi-id = <0x02>;
		phandle = <0x39>;
	};

	cam_a@15004000 {
		compatible = "mediatek,cam_a";
		reg = <0x00 0x15004000 0x00 0x1000>;
	};

	cam_b@15005000 {
		compatible = "mediatek,cam_b";
		reg = <0x00 0x15005000 0x00 0x1000>;
		interrupts = <0x00 0xd9 0x08>;
	};

	cam_c@15006000 {
		compatible = "mediatek,cam_c";
		reg = <0x00 0x15006000 0x00 0x1000>;
		interrupts = <0x00 0xda 0x08>;
	};

	cam_d@15007000 {
		compatible = "mediatek,cam_d";
		reg = <0x00 0x15007000 0x00 0x1000>;
		interrupts = <0x00 0xdb 0x08>;
	};

	seninf@15008000 {
		compatible = "mediatek,seninf";
		reg = <0x00 0x15008000 0x00 0x1000>;
	};

	camsv@15009000 {
		compatible = "mediatek,camsv";
		reg = <0x00 0x15009000 0x00 0x1000>;
		interrupts = <0x00 0xdc 0x08>;
	};

	cam_a_inner@1500d000 {
		compatible = "mediatek,cam_a_inner";
		reg = <0x00 0x1500d000 0x00 0x1000>;
	};

	cam_c_inner@1500e000 {
		compatible = "mediatek,cam_c_inner";
		reg = <0x00 0x1500e000 0x00 0x1000>;
	};

	cam_d_inner@1500f000 {
		compatible = "mediatek,cam_d_inner";
		reg = <0x00 0x1500f000 0x00 0x1000>;
	};

	venc_global_con@17000000 {
		compatible = "mediatek,venc_global_con\0syscon";
		reg = <0x00 0x17000000 0x00 0x10000>;
		#clock-cells = <0x01>;
		phandle = <0x3b>;
	};

	vdec_gcon@17000000 {
		compatible = "mediatek,vdec_gcon";
		reg = <0x00 0x17000000 0x00 0x1000>;
		clocks = <0x3b 0x03 0x3b 0x01 0x1e 0x06 0x1e 0x06>;
		clock-names = "MT_CG_VDEC\0MT_CG_VENC\0MT_SCP_SYS_VDE\0MT_SCP_SYS_VEN";
	};

	venc_jpg@17030000 {
		compatible = "mediatek,venc_jpg";
		reg = <0x00 0x17030000 0x00 0x1000>;
		interrupts = <0x00 0xd6 0x08>;
		clocks = <0x3b 0x02>;
		clock-names = "MT_CG_VENC_JPGENC";
	};

	vdec@17040000 {
		compatible = "mediatek,vdec";
		reg = <0x00 0x17040000 0x00 0x10000>;
		interrupts = <0x00 0xd7 0x08>;
	};

	smi_larb3@17010000 {
		compatible = "mediatek,smi_larb3";
		reg = <0x00 0x17010000 0x00 0x1000>;
		interrupts = <0x00 0xe7 0x08>;
	};

	venc@17020000 {
		compatible = "mediatek,venc";
		reg = <0x00 0x17020000 0x00 0x1000>;
		interrupts = <0x00 0xd4 0x08>;
		phandle = <0x84>;
	};

	smi_larb1@17010000 {
		compatible = "mediatek,smi_larb1\0mediatek,smi_larb";
		reg = <0x00 0x17010000 0x00 0x1000>;
		interrupts = <0x00 0xd5 0x08>;
		clocks = <0x1e 0x06 0x3b 0x00 0x3b 0x01>;
		clock-names = "mtcmos-ven\0venc-larb\0venc-venc";
		mediatek,smi-id = <0x01>;
		phandle = <0x38>;
	};

	mt6357_gauge {
		compatible = "mediatek,mt6357_gauge";
		gauge_name = "gauge";
		alias_name = "mt6357";
	};

	gauge_timer {
		compatible = "mediatek,gauge_timer_service";
	};

	battery {
		compatible = "mediatek,bat_gm30";
		DIFFERENCE_FULLOCV_ITH = <0xc8>;
		SHUTDOWN_1_TIME = <0x3c>;
		KEEP_100_PERCENT = <0x01>;
		R_FG_VALUE = <0x0a>;
		EMBEDDED_SEL = <0x00>;
		PMIC_SHUTDOWN_CURRENT = <0x14>;
		FG_METER_RESISTANCE = <0x140>;
		CAR_TUNE_VALUE = <0x64>;
		PMIC_MIN_VOL = <0x84d0>;
		POWERON_SYSTEM_IBOOT = <0x1f4>;
		SHUTDOWN_GAUGE0_VOLTAGE = <0x84d0>;
		TEMPERATURE_T0 = <0x32>;
		TEMPERATURE_T1 = <0x19>;
		TEMPERATURE_T2 = <0x0a>;
		TEMPERATURE_T3 = <0x00>;
		TEMPERATURE_T4 = <0xfffffff6>;
		g_FG_PSEUDO100_T0 = <0x64>;
		g_FG_PSEUDO100_T1 = <0x64>;
		g_FG_PSEUDO100_T2 = <0x64>;
		g_FG_PSEUDO100_T3 = <0x64>;
		g_FG_PSEUDO100_T4 = <0x64>;
		Q_MAX_SYS_VOLTAGE_BAT0 = <0xd16>;
		Q_MAX_SYS_VOLTAGE_BAT1 = <0xd16>;
		Q_MAX_SYS_VOLTAGE_BAT2 = <0xd16>;
		Q_MAX_SYS_VOLTAGE_BAT3 = <0xd16>;
		battery0_profile_t0_num = <0x64>;
		battery0_profile_t0 = <0x00 0xaac8 0x49c 0x104 0xaa4a 0x498 0x209 0xa9ce 0x497 0x30d 0xa956 0x497 0x411 0xa8df 0x49a 0x516 0xa869 0x4ae 0x61a 0xa7f6 0x4b0 0x71e 0xa77c 0x4b0 0x822 0xa701 0x4b0 0x927 0xa68a 0x4af 0xa2b 0xa610 0x49c 0xb2f 0xa598 0x4a6 0xc34 0xa522 0x4b0 0xd38 0xa4ac 0x4b0 0xe3c 0xa439 0x4b0 0xf41 0xa3c3 0x4b0 0x1045 0xa34d 0x4bc 0x1149 0xa2d8 0x4c2 0x124d 0xa265 0x4b1 0x1352 0xa1f7 0x4c5 0x1456 0xa189 0x4d9 0x155a 0xa118 0x4d8 0x165f 0xa0a6 0x4cd 0x1763 0xa038 0x4e1 0x1867 0x9fc9 0x4e2 0x196c 0x9f5d 0x4e2 0x1a70 0x9ef3 0x4e9 0x1b74 0x9e8d 0x4fb 0x1c78 0x9e26 0x4fb 0x1d7d 0x9dc9 0x51b 0x1e81 0x9d67 0x522 0x1f85 0x9d04 0x519 0x208a 0x9ca8 0x52c 0x218e 0x9c49 0x540 0x2292 0x9bf0 0x554 0x2397 0x9b9a 0x567 0x249b 0x9b46 0x57a 0x259f 0x9aef 0x58e 0x26a4 0x9a98 0x5b3 0x27a8 0x9a47 0x5d9 0x28ac 0x99f4 0x5f0 0x29b0 0x998d 0x5db 0x2ab5 0x98ef 0x551 0x2bb9 0x9860 0x4f4 0x2cbd 0x97ec 0x4c0 0x2dc2 0x9797 0x4b0 0x2ec6 0x9748 0x4b0 0x2fca 0x9709 0x4b0 0x30cf 0x96cb 0x4a4 0x31d3 0x968e 0x49d 0x32d7 0x9657 0x4b0 0x33db 0x9621 0x4b0 0x34e0 0x95ea 0x4b0 0x35e4 0x95b7 0x4ba 0x36e8 0x9588 0x4c5 0x37ed 0x955a 0x4b2 0x38f1 0x952b 0x4c2 0x39f5 0x9501 0x4c9 0x3afa 0x94da 0x4d0 0x3bfe 0x94b3 0x4e2 0x3d02 0x948c 0x4e2 0x3e06 0x946b 0x4f2 0x3f0b 0x9448 0x4fb 0x400f 0x9423 0x4fb 0x4113 0x9403 0x4fb 0x4218 0x93eb 0x521 0x431c 0x93cf 0x52d 0x4420 0x93b0 0x52d 0x4525 0x938e 0x52b 0x4629 0x935f 0x517 0x472d 0x9310 0x4e3 0x4832 0x92c3 0x4be 0x4936 0x9285 0x4b5 0x4a3a 0x925e 0x4c9 0x4b3e 0x9230 0x4c9 0x4c43 0x9201 0x4bb 0x4d47 0x91d5 0x4b9 0x4e4b 0x91ae 0x4c6 0x4f50 0x9187 0x4b3 0x5054 0x9167 0x4c1 0x5158 0x9143 0x4c9 0x525d 0x9114 0x4c9 0x5361 0x90d7 0x4c9 0x5465 0x9098 0x4c9 0x5569 0x905f 0x4c9 0x566e 0x9019 0x4c9 0x5772 0x8fcd 0x4c9 0x5876 0x8fa6 0x4c9 0x597b 0x8f94 0x4c9 0x5a7f 0x8f89 0x4d5 0x5b83 0x8f7f 0x4ef 0x5c88 0x8f6d 0x514 0x5d8c 0x8f3f 0x514 0x5e90 0x8e8c 0x514 0x5f94 0x8d3e 0x527 0x6099 0x8b5b 0x560 0x619d 0x8906 0x5d3 0x62a1 0x8552 0x6a3 0x63a6 0x7eab 0x1ce1 0x64aa 0x70c6 0x1d7e>;
		battery0_profile_t1_num = <0x64>;
		battery0_profile_t1 = <0x00 0xaa0a 0x758 0x104 0xa97c 0x754 0x209 0xa8fc 0x761 0x30d 0xa87d 0x764 0x411 0xa7f9 0x759 0x516 0xa783 0x781 0x61a 0xa709 0x774 0x71e 0xa691 0x778 0x822 0xa618 0x785 0x927 0xa59a 0x785 0xa2b 0xa528 0x785 0xb2f 0xa4b2 0x785 0xc34 0xa43c 0x785 0xd38 0xa3c6 0x789 0xe3c 0xa353 0x79c 0xf41 0xa2dd 0x79e 0x1045 0xa26c 0x7aa 0x1149 0xa1fc 0x7b7 0x124d 0xa189 0x7b8 0x1352 0xa11b 0x7cc 0x1456 0xa0ad 0x7e0 0x155a 0xa040 0x7f3 0x165f 0x9fd4 0x802 0x1763 0x9f66 0x802 0x1867 0x9f0e 0x827 0x196c 0x9ec8 0x85b 0x1a70 0x9e76 0x87f 0x1b74 0x9dfa 0x87b 0x1c78 0x9d54 0x853 0x1d7d 0x9ccd 0x86d 0x1e81 0x9c59 0x87f 0x1f85 0x9c00 0x88e 0x208a 0x9bca 0x8c8 0x218e 0x9b84 0x8ca 0x2292 0x9b37 0x8d8 0x2397 0x9ae6 0x8e3 0x249b 0x9a91 0x8e1 0x259f 0x9a32 0x8cd 0x26a4 0x99c6 0x8a8 0x27a8 0x9943 0x84a 0x28ac 0x98b5 0x7d3 0x29b0 0x982f 0x785 0x2ab5 0x97d8 0x771 0x2bb9 0x9789 0x75e 0x2cbd 0x973f 0x753 0x2dc2 0x96f9 0x753 0x2ec6 0x96ba 0x753 0x2fca 0x9684 0x753 0x30cf 0x964d 0x753 0x31d3 0x9619 0x759 0x32d7 0x95e9 0x76b 0x33db 0x95b3 0x758 0x34e0 0x9582 0x762 0x35e4 0x9557 0x776 0x36e8 0x9530 0x785 0x37ed 0x9509 0x785 0x38f1 0x94e2 0x797 0x39f5 0x94bb 0x79e 0x3afa 0x9497 0x7a5 0x3bfe 0x9478 0x7b8 0x3d02 0x9458 0x7cc 0x3e06 0x9439 0x7e0 0x3f0b 0x941a 0x7e9 0x400f 0x93f9 0x7e5 0x4113 0x93d2 0x7d1 0x4218 0x93b9 0x7e3 0x431c 0x9398 0x7e9 0x4420 0x9371 0x7e1 0x4525 0x9349 0x7d0 0x4629 0x9322 0x7d0 0x472d 0x92fb 0x7c0 0x4832 0x92d5 0x7ac 0x4936 0x92ad 0x79e 0x4a3a 0x9286 0x79e 0x4b3e 0x925f 0x78b 0x4c43 0x923e 0x793 0x4d47 0x921e 0x7a7 0x4e4b 0x91fc 0x7b7 0x4f50 0x91ce 0x7b7 0x5054 0x9192 0x7b7 0x5158 0x9153 0x7ab 0x525d 0x9117 0x7aa 0x5361 0x90e0 0x7d0 0x5465 0x908a 0x7bc 0x5569 0x904b 0x7b7 0x566e 0x902a 0x7c9 0x5772 0x9021 0x7ec 0x5876 0x9011 0x800 0x597b 0x9002 0x838 0x5a7f 0x8fe8 0x88a 0x5b83 0x8f97 0x8ca 0x5c88 0x8ed1 0x8cb 0x5d8c 0x8d24 0x8de 0x5e90 0x8aea 0x979 0x5f94 0x87db 0xaa9 0x6099 0x832b 0x142c 0x619d 0x7b2c 0x36b5 0x62a1 0x758a 0x2887 0x63a6 0x758a 0x2887 0x64aa 0x758a 0x2887>;
		battery0_profile_t2_num = <0x64>;
		battery0_profile_t2 = <0x00 0xaa50 0x7ee 0x104 0xa98b 0x7ea 0x209 0xa80b 0x795 0x30d 0xa6a0 0x94b 0x411 0xa5b9 0xd42 0x516 0xa51b 0xdb8 0x61a 0xa49d 0xdd6 0x71e 0xa420 0xdf5 0x822 0xa3a7 0xe16 0x927 0xa338 0xe2a 0xa2b 0xa2c6 0xe3d 0xb2f 0xa250 0xe51 0xc34 0xa1de 0xe64 0xd38 0xa16e 0xe80 0xe3c 0xa0fb 0xeb9 0xf41 0xa08c 0xed1 0x1045 0xa01e 0xee4 0x1149 0x9fb9 0xeff 0x124d 0x9f66 0xf27 0x1352 0x9f27 0xf62 0x1456 0x9ec9 0xfac 0x155a 0x9e40 0xfbe 0x165f 0x9d93 0xf9c 0x1763 0x9cd5 0xf88 0x1867 0x9c36 0xf74 0x196c 0x9bb0 0xf61 0x1a70 0x9b3d 0xf64 0x1b74 0x9ad8 0xf81 0x1c78 0x9a79 0xf45 0x1d7d 0x9a16 0xf1c 0x1e81 0x99b5 0xef5 0x1f85 0x995a 0xec9 0x208a 0x9905 0xe8f 0x218e 0x98af 0xe7a 0x2292 0x9858 0xe74 0x2397 0x9809 0xe74 0x249b 0x97c4 0xe74 0x259f 0x977d 0xe74 0x26a4 0x973c 0xe96 0x27a8 0x96fe 0xeb1 0x28ac 0x96c3 0xec4 0x29b0 0x968b 0xed8 0x2ab5 0x964c 0xec4 0x2bb9 0x961a 0xeea 0x2cbd 0x95e8 0xf13 0x2dc2 0x95b2 0xf26 0x2ec6 0x9583 0xf3a 0x2fca 0x9555 0xf4d 0x30cf 0x952b 0xf78 0x31d3 0x9503 0xfad 0x32d7 0x94db 0xfd2 0x33db 0x94ad 0xfd2 0x34e0 0x9484 0xfc3 0x35e4 0x945d 0xfcc 0x36e8 0x9436 0xff3 0x37ed 0x940f 0x101a 0x38f1 0x93e8 0x102f 0x39f5 0x93c1 0x1029 0x3afa 0x939a 0x102b 0x3bfe 0x9373 0x1052 0x3d02 0x934c 0x1079 0x3e06 0x931e 0x1061 0x3f0b 0x92f8 0x1059 0x400f 0x92d7 0x106c 0x4113 0x92b0 0x1080 0x4218 0x9281 0x1081 0x431c 0x9258 0x10a9 0x4420 0x9228 0x10cc 0x4525 0x91ea 0x10d1 0x4629 0x91b2 0x10f8 0x472d 0x917c 0x111f 0x4832 0x9139 0x113b 0x4936 0x90ec 0x114e 0x4a3a 0x90a6 0x1163 0x4b3e 0x9087 0x11af 0x4c43 0x9073 0x1219 0x4d47 0x9060 0x128f 0x4e4b 0x9048 0x130f 0x4f50 0x9031 0x13bb 0x5054 0x8fea 0x14b0 0x5158 0x8f18 0x156a 0x525d 0x8da0 0x1605 0x5361 0x8b83 0x16cb 0x5465 0x8856 0x18df 0x5569 0x82fd 0x1fb2 0x566e 0x7955 0x31ec 0x5772 0x7184 0x254e 0x5876 0x7184 0x254e 0x597b 0x7184 0x254e 0x5a7f 0x7184 0x254e 0x5b83 0x7184 0x254e 0x5c88 0x7184 0x254e 0x5d8c 0x7184 0x254e 0x5e90 0x7184 0x254e 0x5f94 0x7184 0x254e 0x6099 0x7184 0x254e 0x619d 0x7184 0x254e 0x62a1 0x7184 0x254e 0x63a6 0x7184 0x254e 0x64aa 0x7184 0x254e>;
		battery0_profile_t3_num = <0x64>;
		battery0_profile_t3 = <0x00 0xa974 0x1054 0x104 0xa8ce 0x1050 0x209 0xa82c 0x10a3 0x30d 0xa783 0x1117 0x411 0xa6c2 0x1191 0x516 0xa5c6 0x121b 0x61a 0xa48c 0x1407 0x71e 0xa360 0x16ed 0x822 0xa25b 0x19fa 0x927 0xa188 0x1c13 0xa2b 0xa0df 0x1d0c 0xb2f 0xa03f 0x1d95 0xc34 0x9fac 0x1dc9 0xd38 0x9f29 0x1dc9 0xe3c 0x9eae 0x1dc9 0xf41 0x9e3e 0x1ddb 0x1045 0x9dda 0x1dfb 0x1149 0x9d74 0x1e29 0x124d 0x9cfe 0x1e5e 0x1352 0x9c50 0x1e4a 0x1456 0x9b96 0x1e17 0x155a 0x9af0 0x1de7 0x165f 0x9a66 0x1dc5 0x1763 0x99f8 0x1db1 0x1867 0x99a7 0x1dfb 0x196c 0x9964 0x1e48 0x1a70 0x9929 0x1e78 0x1b74 0x98f2 0x1e78 0x1c78 0x98bb 0x1e78 0x1d7d 0x9872 0x1e88 0x1e81 0x9828 0x1ebb 0x1f85 0x97de 0x1ef5 0x208a 0x9789 0x1ef5 0x218e 0x9733 0x1ef5 0x2292 0x96dc 0x1ee7 0x2397 0x9686 0x1edc 0x249b 0x9633 0x1eea 0x259f 0x95e4 0x1f60 0x26a4 0x958e 0x1f72 0x27a8 0x9534 0x1f7d 0x28ac 0x94d8 0x1fa1 0x29b0 0x9479 0x1fef 0x2ab5 0x941a 0x1fef 0x2bb9 0x93be 0x201a 0x2cbd 0x9361 0x203a 0x2dc2 0x9303 0x2047 0x2ec6 0x92ad 0x2096 0x2fca 0x925f 0x20f4 0x30cf 0x9216 0x2132 0x31d3 0x91d1 0x2160 0x32d7 0x9192 0x21a4 0x33db 0x914d 0x2277 0x34e0 0x90f5 0x2304 0x35e4 0x907f 0x238d 0x36e8 0x8fe0 0x242e 0x37ed 0x8f02 0x24db 0x38f1 0x8d80 0x2568 0x39f5 0x8b9b 0x2483 0x3afa 0x88fd 0x2106 0x3bfe 0x83d0 0x2893 0x3d02 0x758f 0x3017 0x3e06 0x7580 0x31e7 0x3f0b 0x7580 0x31e7 0x400f 0x7580 0x31e7 0x4113 0x7580 0x31e7 0x4218 0x7580 0x31e7 0x431c 0x7580 0x31e7 0x4420 0x7580 0x31e7 0x4525 0x7580 0x31e7 0x4629 0x7580 0x31e7 0x472d 0x7580 0x31e7 0x4832 0x7580 0x31e7 0x4936 0x7580 0x31e7 0x4a3a 0x7580 0x31e7 0x4b3e 0x7580 0x31e7 0x4c43 0x7580 0x31e7 0x4d47 0x7580 0x31e7 0x4e4b 0x7580 0x31e7 0x4f50 0x7580 0x31e7 0x5054 0x7580 0x31e7 0x5158 0x7580 0x31e7 0x525d 0x7580 0x31e7 0x5361 0x7580 0x31e7 0x5465 0x7580 0x31e7 0x5569 0x7580 0x31e7 0x566e 0x7580 0x31e7 0x5772 0x7580 0x31e7 0x5876 0x7580 0x31e7 0x597b 0x7580 0x31e7 0x5a7f 0x7580 0x31e7 0x5b83 0x7580 0x31e7 0x5c88 0x7580 0x31e7 0x5d8c 0x7580 0x31e7 0x5e90 0x7580 0x31e7 0x5f94 0x7580 0x31e7 0x6099 0x7580 0x31e7 0x619d 0x7580 0x31e7 0x62a1 0x7580 0x31e7 0x63a6 0x7580 0x31e7 0x64aa 0x7580 0x31e7>;
		battery0_profile_t4_num = <0x64>;
		battery0_profile_t4 = <0x00 0xa6c2 0x2d1e 0x104 0xa614 0x2d1e 0x209 0xa570 0x2ce6 0x30d 0xa4d1 0x2c88 0x411 0xa431 0x2c27 0x516 0xa383 0x2c3b 0x61a 0xa2c6 0x2c2c 0x71e 0xa1c7 0x2cdc 0x822 0xa06c 0x2f3d 0x927 0x9eb1 0x340b 0xa2b 0x9d87 0x37db 0xb2f 0x9c96 0x39fb 0xc34 0x9bb5 0x3b73 0xd38 0x9acd 0x3c88 0xe3c 0x99d8 0x3c75 0xf41 0x98f9 0x3cba 0x1045 0x983a 0x3cd7 0x1149 0x9797 0x3cc9 0x124d 0x9707 0x3ca9 0x1352 0x9688 0x3ce4 0x1456 0x961d 0x3cd1 0x155a 0x95b6 0x3cdd 0x165f 0x9551 0x3cca 0x1763 0x94e6 0x3bcf 0x1867 0x9460 0x3a71 0x196c 0x93b7 0x38cb 0x1a70 0x92f6 0x36ff 0x1b74 0x9212 0x34da 0x1c78 0x9036 0x3981 0x1d7d 0x8d7f 0x4209 0x1e81 0x8a23 0x45d0 0x1f85 0x84ab 0x4ddc 0x208a 0x7d5a 0x3d86 0x218e 0x7d5a 0x3d86 0x2292 0x7d5a 0x3d86 0x2397 0x7d5a 0x3d86 0x249b 0x7d5a 0x3d86 0x259f 0x7d5a 0x3d86 0x26a4 0x7d5a 0x3d86 0x27a8 0x7d5a 0x3d86 0x28ac 0x7d5a 0x3d86 0x29b0 0x7d5a 0x3d86 0x2ab5 0x7d5a 0x3d86 0x2bb9 0x7d5a 0x3d86 0x2cbd 0x7d5a 0x3d86 0x2dc2 0x7d5a 0x3d86 0x2ec6 0x7d5a 0x3d86 0x2fca 0x7d5a 0x3d86 0x30cf 0x7d5a 0x3d86 0x31d3 0x7d5a 0x3d86 0x32d7 0x7d5a 0x3d86 0x33db 0x7d5a 0x3d86 0x34e0 0x7d5a 0x3d86 0x35e4 0x7d5a 0x3d86 0x36e8 0x7d5a 0x3d86 0x37ed 0x7d5a 0x3d86 0x38f1 0x7d5a 0x3d86 0x39f5 0x7d5a 0x3d86 0x3afa 0x7d5a 0x3d86 0x3bfe 0x7d5a 0x3d86 0x3d02 0x7d5a 0x3d86 0x3e06 0x7d5a 0x3d86 0x3f0b 0x7d5a 0x3d86 0x400f 0x7d5a 0x3d86 0x4113 0x7d5a 0x3d86 0x4218 0x7d5a 0x3d86 0x431c 0x7d5a 0x3d86 0x4420 0x7d5a 0x3d86 0x4525 0x7d5a 0x3d86 0x4629 0x7d5a 0x3d86 0x472d 0x7d5a 0x3d86 0x4832 0x7d5a 0x3d86 0x4936 0x7d5a 0x3d86 0x4a3a 0x7d5a 0x3d86 0x4b3e 0x7d5a 0x3d86 0x4c43 0x7d5a 0x3d86 0x4d47 0x7d5a 0x3d86 0x4e4b 0x7d5a 0x3d86 0x4f50 0x7d5a 0x3d86 0x5054 0x7d5a 0x3d86 0x5158 0x7d5a 0x3d86 0x525d 0x7d5a 0x3d86 0x5361 0x7d5a 0x3d86 0x5465 0x7d5a 0x3d86 0x5569 0x7d5a 0x3d86 0x566e 0x7d5a 0x3d86 0x5772 0x7d5a 0x3d86 0x5876 0x7d5a 0x3d86 0x597b 0x7d5a 0x3d86 0x5a7f 0x7d5a 0x3d86 0x5b83 0x7d5a 0x3d86 0x5c88 0x7d5a 0x3d86 0x5d8c 0x7d5a 0x3d86 0x5e90 0x7d5a 0x3d86 0x5f94 0x7d5a 0x3d86 0x6099 0x7d5a 0x3d86 0x619d 0x7d5a 0x3d86 0x62a1 0x7d5a 0x3d86 0x63a6 0x7d5a 0x3d86 0x64aa 0x7d5a 0x3d86>;
		battery2_profile_t0_num = <0x64>;
		battery2_profile_t0 = <0x00 0xab7c 0x47e 0x102 0xaad0 0x47e 0x205 0xaa40 0x47e 0x307 0xa9b9 0x46f 0x40a 0xa936 0x465 0x50c 0xa8bc 0x465 0x60f 0xa848 0x460 0x711 0xa7c7 0x44f 0x814 0xa753 0x47c 0x916 0xa6d3 0x469 0xa19 0xa658 0x465 0xb1b 0xa5e0 0x465 0xc1e 0xa565 0x465 0xd20 0xa4ed 0x46d 0xe23 0xa47b 0x47a 0xf25 0xa403 0x466 0x1028 0xa393 0x491 0x112a 0xa31f 0x497 0x122d 0xa2ae 0x497 0x132f 0xa23e 0x497 0x1432 0xa1ce 0x4a0 0x1534 0xa15b 0x4b0 0x1637 0xa0e1 0x4b0 0x1739 0xa07a 0x4b0 0x183c 0xa002 0x49b 0x193e 0x9f90 0x497 0x1a41 0x9f29 0x4b4 0x1b43 0x9ec4 0x4c9 0x1c46 0x9e5d 0x4d1 0x1d48 0x9df6 0x4e2 0x1e4b 0x9d8e 0x4e3 0x1f4d 0x9d2c 0x4fa 0x2050 0x9ccd 0x4fb 0x2152 0x9c75 0x50c 0x2254 0x9c1f 0x514 0x2357 0x9bc8 0x528 0x2459 0x9b72 0x54d 0x255c 0x9b22 0x55b 0x265e 0x9ac3 0x546 0x2761 0x9a76 0x571 0x2863 0x9a26 0x58b 0x2966 0x99c5 0x581 0x2a68 0x994f 0x547 0x2b6b 0x98ce 0x4fa 0x2c6d 0x9852 0x4b9 0x2d70 0x97ea 0x481 0x2e72 0x979d 0x496 0x2f75 0x974f 0x482 0x3077 0x9709 0x46d 0x317a 0x96c8 0x465 0x327c 0x968f 0x470 0x337f 0x9658 0x476 0x3481 0x961f 0x46e 0x3584 0x95f4 0x496 0x3686 0x95bf 0x480 0x3789 0x958b 0x47e 0x388b 0x9564 0x48e 0x398e 0x9537 0x497 0x3a90 0x950e 0x4aa 0x3b93 0x94ec 0x4bc 0x3c95 0x94bb 0x49a 0x3d98 0x9498 0x4b0 0x3e9a 0x947e 0x4db 0x3f9d 0x945d 0x4d0 0x409f 0x9434 0x4ba 0x41a2 0x9417 0x4d3 0x42a4 0x9402 0x503 0x43a6 0x93e6 0x50f 0x44a9 0x93c4 0x4fc 0x45ab 0x93aa 0x513 0x46ae 0x9367 0x4d7 0x47b0 0x931b 0x4a7 0x48b3 0x92d3 0x497 0x49b5 0x9299 0x497 0x4ab8 0x926d 0x49e 0x4bba 0x9241 0x4ac 0x4cbd 0x920d 0x497 0x4dbf 0x91e2 0x497 0x4ec2 0x91bd 0x4aa 0x4fc4 0x9194 0x4a0 0x50c7 0x9173 0x4a3 0x51c9 0x914f 0x4a7 0x52cc 0x911a 0x497 0x53ce 0x90e4 0x49a 0x54d1 0x90a8 0x4af 0x55d3 0x9074 0x49b 0x56d6 0x9039 0x4a8 0x57d8 0x8fea 0x493 0x58db 0x8fb2 0x495 0x59dd 0x8f9c 0x4a8 0x5ae0 0x8f8c 0x49b 0x5be2 0x8f83 0x4b3 0x5ce5 0x8f71 0x4f6 0x5de7 0x8f48 0x50f 0x5eea 0x8ead 0x4e3 0x5fec 0x8d73 0x4f0 0x60ef 0x8b99 0x532 0x61f1 0x8920 0x589 0x62f4 0x85d2 0x637 0x63f6 0x80e8 0x7d0>;
		battery2_profile_t1_num = <0x64>;
		battery2_profile_t1 = <0x00 0xab22 0x76c 0x102 0xaa7e 0x76c 0x205 0xa9f8 0x790 0x307 0xa979 0x78f 0x40a 0xa8ff 0x785 0x50c 0xa883 0x77c 0x60f 0xa804 0x767 0x711 0xa78b 0x755 0x814 0xa70e 0x76b 0x916 0xa69d 0x76c 0xa19 0xa620 0x75b 0xb1b 0xa5a4 0x753 0xc1e 0xa52d 0x753 0xd20 0xa4b8 0x75b 0xe23 0xa441 0x768 0xf25 0xa3d1 0x754 0x1028 0xa361 0x769 0x112a 0xa2e6 0x759 0x122d 0xa279 0x763 0x132f 0xa20c 0x779 0x1432 0xa19c 0x785 0x1534 0xa12b 0x785 0x1637 0xa0b8 0x785 0x1739 0xa048 0x785 0x183c 0x9fd8 0x785 0x193e 0x9f6f 0x7a8 0x1a41 0x9f0b 0x7c6 0x1b43 0x9ebe 0x7e7 0x1c46 0x9e71 0x7fa 0x1d48 0x9e02 0x7e9 0x1e4b 0x9d78 0x7e8 0x1f4d 0x9ce9 0x7d1 0x2050 0x9c6f 0x7bc 0x2152 0x9c18 0x7fa 0x2254 0x9bd5 0x835 0x2357 0x9b94 0x84d 0x2459 0x9b4a 0x84d 0x255c 0x9afb 0x849 0x265e 0x9aa5 0x834 0x2761 0x9a4f 0x834 0x2863 0x99e0 0x7fb 0x2966 0x9968 0x7ba 0x2a68 0x98f5 0x779 0x2b6b 0x9885 0x730 0x2c6d 0x981c 0x6ef 0x2d70 0x97cb 0x6e7 0x2e72 0x9775 0x6a6 0x2f75 0x9730 0x6a4 0x3077 0x96f2 0x6b5 0x317a 0x96ae 0x692 0x327c 0x9676 0x694 0x337f 0x9647 0x6c5 0x3481 0x9615 0x6d2 0x3584 0x95ea 0x6bd 0x3686 0x95b5 0x6bd 0x3789 0x9589 0x6e4 0x388b 0x955d 0x6ef 0x398e 0x9532 0x6fc 0x3a90 0x950b 0x712 0x3b93 0x94e5 0x714 0x3c95 0x94bc 0x6f6 0x3d98 0x94a2 0x721 0x3e9a 0x9480 0x721 0x3f9d 0x945d 0x721 0x409f 0x9440 0x730 0x41a2 0x9426 0x73a 0x42a4 0x940c 0x742 0x43a6 0x93f0 0x753 0x44a9 0x93ce 0x753 0x45ab 0x93b4 0x753 0x46ae 0x9389 0x73f 0x47b0 0x9365 0x73a 0x48b3 0x9338 0x71f 0x49b5 0x9310 0x712 0x4ab8 0x92ec 0x71a 0x4bba 0x92bd 0x70c 0x4cbd 0x92a3 0x721 0x4dbf 0x926f 0x70b 0x4ec2 0x9251 0x72e 0x4fc4 0x9231 0x73a 0x50c7 0x920e 0x746 0x51c9 0x91e1 0x74a 0x52cc 0x91a6 0x740 0x53ce 0x9170 0x753 0x54d1 0x9134 0x753 0x55d3 0x9108 0x792 0x56d6 0x90c8 0x7af 0x57d8 0x9076 0x7a9 0x58db 0x903e 0x7a9 0x59dd 0x902b 0x7c7 0x5ae0 0x9022 0x7f6 0x5be2 0x901a 0x839 0x5ce5 0x9011 0x8a9 0x5de7 0x8fe0 0x901 0x5eea 0x8f43 0x925 0x5fec 0x8df4 0x93b 0x60ef 0x8bfb 0x9aa 0x61f1 0x8957 0xa9b 0x62f4 0x85a0 0xc1e 0x63f6 0x7fbc 0xfd2>;
		battery2_profile_t2_num = <0x64>;
		battery2_profile_t2 = <0x00 0xaa6e 0x109a 0x102 0xa997 0x109a 0x205 0xa900 0x10f4 0x307 0xa873 0x1144 0x40a 0xa7ec 0x1162 0x50c 0xa76b 0x1162 0x60f 0xa6ec 0x1162 0x711 0xa673 0x1162 0x814 0xa5f6 0x1162 0x916 0xa585 0x114d 0xa19 0xa50e 0x1149 0xb1b 0xa496 0x1149 0xc1e 0xa41b 0x1134 0xd20 0xa3a3 0x1117 0xe23 0xa333 0x111b 0xf25 0xa2c3 0x112f 0x1028 0xa253 0x1104 0x112a 0xa1e7 0x10fe 0x122d 0xa178 0x110e 0x132f 0xa10e 0x1117 0x1432 0xa0a2 0x1117 0x1534 0xa031 0x1117 0x1637 0x9fc1 0x1117 0x1739 0x9f62 0x1117 0x183c 0x9f14 0x112c 0x193e 0x9ec6 0x1142 0x1a41 0x9e60 0x1149 0x1b43 0x9dd7 0x1132 0x1c46 0x9d3b 0x110f 0x1d48 0x9ca6 0x10f9 0x1e4b 0x9c26 0x10e6 0x1f4d 0x9bbb 0x10fd 0x2050 0x9b63 0x10ea 0x2152 0x9b1b 0x1117 0x2254 0x9ad6 0x1130 0x2357 0x9a88 0x111c 0x2459 0x9a2d 0x10f0 0x255c 0x99cb 0x10c1 0x265e 0x995b 0x1080 0x2761 0x98eb 0x102a 0x2863 0x987f 0x100a 0x2966 0x9817 0xfd5 0x2a68 0x97c8 0xfd1 0x2b6b 0x9781 0xfd1 0x2c6d 0x9731 0xfa5 0x2d70 0x96f3 0xfb9 0x2e72 0x96b6 0xfb9 0x2f75 0x967a 0xfb9 0x3077 0x963e 0xfca 0x317a 0x9606 0xfe0 0x327c 0x95d6 0x1001 0x337f 0x95a7 0x101d 0x3481 0x9575 0x1021 0x3584 0x954b 0x1038 0x3686 0x9527 0x1064 0x3789 0x94f5 0x1068 0x388b 0x94d4 0x1089 0x398e 0x94b6 0x10a7 0x3a90 0x948f 0x10bd 0x3b93 0x9468 0x10d9 0x3c95 0x944d 0x10fe 0x3d98 0x942a 0x10fe 0x3e9a 0x9410 0x1129 0x3f9d 0x93f7 0x1142 0x409f 0x93dc 0x1167 0x41a2 0x93c2 0x117b 0x42a4 0x93a8 0x1183 0x43a6 0x9390 0x1199 0x44a9 0x937f 0x11b0 0x45ab 0x936d 0x11dc 0x46ae 0x935c 0x121c 0x47b0 0x933d 0x122a 0x48b3 0x931b 0x1245 0x49b5 0x92f3 0x125c 0x4ab8 0x92cd 0x1272 0x4bba 0x92b2 0x12b3 0x4cbd 0x928f 0x12f4 0x4dbf 0x9264 0x134a 0x4ec2 0x9230 0x137c 0x4fc4 0x91fc 0x13d7 0x50c7 0x91c3 0x142a 0x51c9 0x918b 0x1486 0x52cc 0x9150 0x1502 0x53ce 0x90ff 0x1571 0x54d1 0x90a8 0x15dd 0x55d3 0x906b 0x1687 0x56d6 0x9052 0x1768 0x57d8 0x903b 0x184c 0x58db 0x9025 0x196b 0x59dd 0x900d 0x1ad4 0x5ae0 0x8fdd 0x1c65 0x5be2 0x8f6b 0x1e26 0x5ce5 0x8e21 0x1fa1 0x5de7 0x8c2a 0x223b 0x5eea 0x8980 0x25f3 0x5fec 0x859b 0x2b83 0x60ef 0x7f8b 0x2cac 0x61f1 0x7b3e 0x230f 0x62f4 0x7b3e 0x230f 0x63f6 0x7b3e 0x230f>;
		battery2_profile_t3_num = <0x64>;
		battery2_profile_t3 = <0x00 0xa988 0x2184 0x102 0xa838 0x2180 0x205 0xa74d 0x22b2 0x307 0xa695 0x2383 0x40a 0xa5fd 0x23be 0x50c 0xa577 0x23be 0x60f 0xa4f6 0x23b9 0x711 0xa475 0x23a5 0x814 0xa401 0x23a5 0x916 0xa389 0x2367 0xa19 0xa310 0x2349 0xb1b 0xa2a3 0x2333 0xc1e 0xa22d 0x22fe 0xd20 0xa1b2 0x22cc 0xe23 0xa14a 0x22d5 0xf25 0xa0e3 0x22aa 0x1028 0xa06a 0x227f 0x112a 0x9ffd 0x2266 0x122d 0x9fa2 0x2260 0x132f 0x9f56 0x226d 0x1432 0x9f06 0x2279 0x1534 0x9e9d 0x2267 0x1637 0x9e12 0x221f 0x1739 0x9d65 0x21b3 0x183c 0x9cca 0x2172 0x193e 0x9c36 0x2143 0x1a41 0x9bbd 0x2151 0x1b43 0x9b59 0x215a 0x1c46 0x9afd 0x214d 0x1d48 0x9aa9 0x214d 0x1e4b 0x9a5b 0x214a 0x1f4d 0x9a02 0x211e 0x2050 0x99ab 0x20f3 0x2152 0x9948 0x20a6 0x2254 0x98e6 0x206b 0x2357 0x9882 0x2035 0x2459 0x981e 0x2001 0x255c 0x97c9 0x1feb 0x265e 0x977b 0x1fd6 0x2761 0x9736 0x1fd6 0x2863 0x96ef 0x1fd6 0x2966 0x96b6 0x1ff5 0x2a68 0x967e 0x2014 0x2b6b 0x9642 0x2018 0x2c6d 0x9607 0x200d 0x2d70 0x95d3 0x2026 0x2e72 0x95a8 0x2051 0x2f75 0x9574 0x207c 0x3077 0x9547 0x2085 0x317a 0x9521 0x20a2 0x327c 0x94fe 0x20c2 0x337f 0x94d9 0x20d8 0x3481 0x94af 0x20f2 0x3584 0x948d 0x211b 0x3686 0x9469 0x211b 0x3789 0x9446 0x2142 0x388b 0x9424 0x215d 0x398e 0x940c 0x2180 0x3a90 0x93f6 0x21b5 0x3b93 0x93df 0x21f0 0x3c95 0x93cd 0x221f 0x3d98 0x93bc 0x225f 0x3e9a 0x93a2 0x2275 0x3f9d 0x9390 0x22d2 0x409f 0x9378 0x2323 0x41a2 0x935e 0x2364 0x42a4 0x9344 0x23ad 0x43a6 0x932a 0x240d 0x44a9 0x930f 0x248a 0x45ab 0x92e3 0x24cd 0x46ae 0x92b7 0x24e5 0x47b0 0x9293 0x24dd 0x48b3 0x926b 0x24c6 0x49b5 0x9237 0x2434 0x4ab8 0x91f9 0x23b3 0x4bba 0x91bf 0x2467 0x4cbd 0x918b 0x253e 0x4dbf 0x914f 0x2615 0x4ec2 0x9101 0x26b6 0x4fc4 0x90c0 0x27ef 0x50c7 0x908d 0x293a 0x51c9 0x9069 0x29df 0x52cc 0x904d 0x29d7 0x53ce 0x9029 0x2a42 0x54d1 0x9007 0x2c47 0x55d3 0x8fa2 0x31ab 0x56d6 0x8eca 0x343b 0x57d8 0x8d37 0x35e3 0x58db 0x8ae8 0x39e7 0x59dd 0x87e6 0x3887 0x5ae0 0x836f 0x311f 0x5be2 0x7b5c 0x2328 0x5ce5 0x7b5c 0x2328 0x5de7 0x7b5c 0x2328 0x5eea 0x7b5c 0x2328 0x5fec 0x7b5c 0x2328 0x60ef 0x7b5c 0x2328 0x61f1 0x7b5c 0x2328 0x62f4 0x7b5c 0x2328 0x63f6 0x7b5c 0x2328>;
		battery2_profile_t4_num = <0x64>;
		battery2_profile_t4 = <0x00 0xa7da 0x2d1e 0x102 0xa68a 0x3a7f 0x205 0xa591 0x3f8a 0x307 0xa4d7 0x40a6 0x40a 0xa43c 0x404d 0x50c 0xa3b0 0x3fb0 0x60f 0xa32d 0x3f22 0x711 0xa2a3 0x3e62 0x814 0xa222 0x3de1 0x916 0xa1a1 0x3d60 0xa19 0xa126 0x3cee 0xb1b 0xa0b2 0x3c8e 0xc1e 0xa042 0x3c38 0xd20 0x9fd2 0x3be7 0xe23 0x9f61 0x3ba3 0xf25 0x9edf 0x3b37 0x1028 0x9e4e 0x3adf 0x112a 0x9db5 0x3a69 0x122d 0x9d15 0x39ce 0x132f 0x9c75 0x3950 0x1432 0x9bdd 0x3910 0x1534 0x9b4c 0x38d4 0x1637 0x9acb 0x38be 0x1739 0x9a52 0x38a9 0x183c 0x99e7 0x3882 0x193e 0x997f 0x3864 0x1a41 0x9920 0x3859 0x1b43 0x98cc 0x3859 0x1c46 0x987f 0x3856 0x1d48 0x9831 0x3840 0x1e4b 0x97ec 0x382b 0x1f4d 0x97a7 0x3815 0x2050 0x9768 0x381c 0x2152 0x9727 0x3827 0x2254 0x96e5 0x382e 0x2357 0x96a9 0x3840 0x2459 0x966b 0x3841 0x255c 0x9637 0x3857 0x265e 0x9604 0x3859 0x2761 0x95d0 0x3869 0x2863 0x959c 0x388b 0x2966 0x956c 0x389b 0x2a68 0x9541 0x3896 0x2b6b 0x9516 0x38bf 0x2c6d 0x94eb 0x38d5 0x2d70 0x94c0 0x38ea 0x2e72 0x9495 0x3900 0x2f75 0x946f 0x3922 0x3077 0x944c 0x394e 0x317a 0x942c 0x3979 0x327c 0x9410 0x39a1 0x337f 0x93e5 0x39b6 0x3481 0x93cb 0x3a0b 0x3584 0x93aa 0x3a3e 0x3686 0x9382 0x3a69 0x3789 0x935b 0x3aa9 0x388b 0x9339 0x3b06 0x398e 0x9315 0x3b6b 0x3a90 0x92ea 0x3bac 0x3b93 0x92bf 0x3c02 0x3c95 0x928c 0x3c58 0x3d98 0x9258 0x3cae 0x3e9a 0x9225 0x3d1b 0x3f9d 0x91ee 0x3d94 0x409f 0x91b3 0x3e0d 0x41a2 0x9180 0x3eb9 0x42a4 0x914c 0x3f50 0x43a6 0x9120 0x3ff9 0x44a9 0x90f5 0x40b5 0x45ab 0x90c5 0x418f 0x46ae 0x9095 0x4285 0x47b0 0x9061 0x4387 0x48b3 0x9012 0x43cf 0x49b5 0x8faa 0x3bd1 0x4ab8 0x8ee4 0x4479 0x4bba 0x8dac 0x47bb 0x4cbd 0x8be2 0x48f3 0x4dbf 0x8996 0x469f 0x4ec2 0x8615 0x3de8 0x4fc4 0x8098 0x3089 0x50c7 0x8098 0x3089 0x51c9 0x8098 0x3089 0x52cc 0x8098 0x3089 0x53ce 0x8098 0x3089 0x54d1 0x8098 0x3089 0x55d3 0x8098 0x3089 0x56d6 0x8098 0x3089 0x57d8 0x8098 0x3089 0x58db 0x8098 0x3089 0x59dd 0x8098 0x3089 0x5ae0 0x8098 0x3089 0x5be2 0x8098 0x3089 0x5ce5 0x8098 0x3089 0x5de7 0x8098 0x3089 0x5eea 0x8098 0x3089 0x5fec 0x8098 0x3089 0x60ef 0x8098 0x3089 0x61f1 0x8098 0x3089 0x62f4 0x8098 0x3089 0x63f6 0x8098 0x3089>;
		phandle = <0x85>;
	};

	mt_charger {
		compatible = "mediatek,mt-charger";
		phandle = <0x86>;
	};

	charger {
		compatible = "mediatek,charger";
		algorithm_name = "SwitchCharging";
		battery_cv = <0x426030>;
		max_charger_voltage = <0x632ea0>;
		min_charger_voltage = <0x4630c0>;
		usb_charger_current_suspend = <0x00>;
		usb_charger_current_unconfigured = <0x11170>;
		usb_charger_current_configured = <0x7a120>;
		usb_charger_current = <0x7a120>;
		ac_charger_current = <0x100590>;
		ac_charger_input_current = <0x100590>;
		non_std_ac_charger_current = <0x7a120>;
		charging_host_charger_current = <0x7a120>;
		apple_1_0a_charger_current = <0x9eb10>;
		apple_2_1a_charger_current = <0xc3500>;
		ta_ac_charger_current = <0x2dc6c0>;
		jeita_temp_above_t4_cv = <0x40b280>;
		jeita_temp_t3_to_t4_cv = <0x40b280>;
		jeita_temp_t2_to_t3_cv = <0x423920>;
		jeita_temp_t1_to_t2_cv = <0x40b280>;
		jeita_temp_t0_to_t1_cv = <0x3da540>;
		jeita_temp_below_t0_cv = <0x3da540>;
		temp_t4_thres = <0x32>;
		temp_t4_thres_minus_x_degree = <0x2f>;
		temp_t3_thres = <0x2d>;
		temp_t3_thres_minus_x_degree = <0x27>;
		temp_t2_thres = <0x0a>;
		temp_t2_thres_plus_x_degree = <0x10>;
		temp_t1_thres = <0x00>;
		temp_t1_thres_plus_x_degree = <0x06>;
		temp_t0_thres = <0x00>;
		temp_t0_thres_plus_x_degree = <0x00>;
		temp_neg_10_thres = <0x00>;
		enable_min_charge_temp;
		min_charge_temp = <0x00>;
		min_charge_temp_plus_x_degree = <0x06>;
		max_charge_temp = <0x32>;
		max_charge_temp_minus_x_degree = <0x2f>;
		pe20_ichg_level_threshold = <0xf4240>;
		ta_start_battery_soc = <0x00>;
		ta_stop_battery_soc = <0x55>;
		chg1_ta_ac_charger_current = <0x16e360>;
		chg2_ta_ac_charger_current = <0x16e360>;
		cable_imp_threshold = <0x2bb>;
		vbat_cable_imp_threshold = <0x3b8260>;
		bif_threshold1 = <0x40d990>;
		bif_threshold2 = <0x419ce0>;
		bif_cv_under_threshold2 = <0x43e6d0>;
		max_charging_time = <0xa8c0>;
		recharge_offset = <0x249f0>;
		topoff_voltage = <0x401640>;
		chg_full_current = <0x249f0>;
		phandle = <0x87>;
	};

	pmic_clock_buffer_ctrl {
		compatible = "mediatek,pmic_clock_buffer";
		mediatek,clkbuf-quantity = <0x07>;
		mediatek,clkbuf-config = <0x02 0x01 0x01 0x02 0x00 0x00 0x00>;
		mediatek,clkbuf-driving-current = <0xffffffff 0xffffffff 0xffffffff 0xffffffff 0xffffffff 0xffffffff 0xffffffff>;
		phandle = <0x88>;
	};

	consys@18070000 {
		compatible = "mediatek,mt6739-consys";
		#address-cells = <0x02>;
		#size-cells = <0x02>;
		reg = <0x00 0x18070000 0x00 0x200 0x00 0x10007000 0x00 0x100 0x00 0x10000000 0x00 0x2000 0x00 0x10006000 0x00 0x1000>;
		interrupts = <0x00 0xe9 0x08 0x00 0xeb 0x02>;
		clocks = <0x1e 0x03>;
		clock-names = "conn";
		phandle = <0x89>;
	};

	fingerprint {
		compatible = "mediatek,goodix-fp";
		phandle = <0x8a>;
	};

	gps {
		compatible = "mediatek,gps";
	};

	als_ps@0 {
		compatible = "mediatek,als_ps";
		phandle = <0x8b>;
	};

	gse_1 {
		phandle = <0x8c>;
	};

	mse {
		phandle = <0x8d>;
	};

	gyro {
		compatible = "mediatek,gyroscope";
		phandle = <0x8e>;
	};

	mrdump_ext_rst {
		compatible = "mediatek, mrdump_ext_rst-eint";
		force_mode = "EINT";
		mode = "IRQ";
		status = "okay";
		phandle = <0x8f>;
	};

	msdc1_ins {
		phandle = <0x90>;
	};

	chr_stat {
		phandle = <0x91>;
	};

	rt9465_slave_chr {
		phandle = <0x92>;
	};

	dsi_te {
		compatible = "mediatek, dsi_te-eint";
		status = "disabled";
		phandle = <0x93>;
	};

	kd_camera_hw1@15008000 {
		compatible = "mediatek,camera_hw";
		reg = <0x00 0x15008000 0x00 0x1000>;
		clocks = <0x29 0x2e 0x29 0x41 0x1b 0x29 0x11 0x29 0x1a 0x29 0x10 0x29 0x1b 0x29 0x12 0x29 0x13 0x29 0x3f 0x29 0x37>;
		clock-names = "CLK_TOP_CAMTG_SEL\0CLK_TOP_CAMTG2_SEL\0CLK_TOP_CLK26M\0CLK_TOP_UNIVPLL_48M_D2\0CLK_TOP_UNIVPLL2_D8\0CLK_TOP_UNIVPLL_D26\0CLK_TOP_UNIVPLL2_D32\0CLK_TOP_UNIVPLL_48M_D4\0CLK_TOP_UNIVPLL_48M_D8\0CLK_TOP_SENINF_SEL\0CLK_TOP_SCAM_SEL";
		phandle = <0x94>;
	};

	otg_iddig {
		compatible = "mediatek,usb_iddig_bi_eint";
		phandle = <0x95>;
	};

	nfc {
		compatible = "mediatek,nfc-gpio-v2";
		gpio-rst = <0x07>;
		gpio-rst-std = <0x17 0x07 0x00>;
		gpio-irq = <0x0e>;
		gpio-irq-std = <0x17 0x0e 0x00>;
		phandle = <0x96>;
	};

	irq_nfc {
		compatible = "mediatek,irq_nfc-eint";
		phandle = <0x97>;
	};

	md1_sim1_hot_plug_eint {
		phandle = <0x98>;
	};

	md1_sim2_hot_plug_eint {
		phandle = <0x99>;
	};

	irtx_pwm {
		compatible = "mediatek,irtx-pwm";
		pwm_ch = <0x01>;
		pwm_data_invert = <0x00>;
		phandle = <0x9a>;
	};

	odm {
		compatible = "simple-bus";
		phandle = <0x9b>;
	};

	radio_md_cfg {
		compatible = "mediatek,radio_md_cfg";
		phandle = <0x9c>;
	};

	dynamic_options {
		compatible = "mediatek,dynamic_options";
		phandle = <0x9d>;
	};

	trusty {
		compatible = "android,trusty-smc-v1";
		ranges;
		#address-cells = <0x02>;
		#size-cells = <0x02>;

		irq {
			compatible = "android,trusty-irq-v1";
			ppi-interrupt-parent = <0x02>;
		};

		log {
			compatible = "android,trusty-log-v1";
		};

		virtio {
			compatible = "android,trusty-virtio-v1";
		};

		mtee {
			compatible = "mediatek,trusty-mtee-v1";
		};
	};

	__symbols__ {
		chosen = "/chosen";
		cpu0 = "/cpus/cpu@0";
		cpu1 = "/cpus/cpu@001";
		cpu2 = "/cpus/cpu@002";
		cpu3 = "/cpus/cpu@003";
		STANDBY = "/cpus/idle-states/standby";
		MCDI_CPU = "/cpus/idle-states/mcdi-cpu";
		MCDI_CLUSTER = "/cpus/idle-states/mcdi-cluster";
		SODI = "/cpus/idle-states/sodi";
		SODI3 = "/cpus/idle-states/sodi3";
		DPIDLE = "/cpus/idle-states/dpidle";
		SUSPEND = "/cpus/idle-states/suspend";
		cpu_dbgapb = "/cpu_dbgapb";
		reserved_memory = "/reserved-memory";
		gic = "/interrupt-controller@0c000000";
		led_red_gpio = "/led_red_gpio";
		sysirq = "/intpol-controller@0x10200620";
		clk26m = "/clk26m";
		topckgen = "/topckgen@10000000";
		infracfg_ao = "/infracfg_ao@10001000";
		scpsys = "/scpsys@10001000";
		clk32k = "/clk32k";
		io_cfg_lt = "/io_cfg_lt@10002000";
		syscfg_pctl_lt = "/syscfg_pctl_lt@10002000";
		io_cfg_lm = "/io_cfg_lm@10002200";
		syscfg_pctl_lm = "/syscfg_pctl_lm@10002200";
		io_cfg_lb = "/io_cfg_lb@10002400";
		syscfg_pctl_lb = "/syscfg_pctl_lb@10002400";
		io_cfg_bl = "/io_cfg_bl@10002600";
		syscfg_pctl_bl = "/syscfg_pctl_bl@10002600";
		io_cfg_bm = "/io_cfg_bm@10002800";
		syscfg_pctl_bm = "/syscfg_pctl_bm@10002800";
		io_cfg_rb = "/io_cfg_rb@10002a00";
		syscfg_pctl_rb = "/syscfg_pctl_rb@10002a00";
		io_cfg_rt = "/io_cfg_rt@10002c00";
		syscfg_pctl_rt = "/syscfg_pctl_bl@10002c00";
		gpio_usage_mapping = "/gpio";
		gpio = "/gpio@10005000";
		syscfg_pctl_a = "/syscfg_pctl_a@10005000";
		accdet = "/accdet";
		pio = "/1000b000.pinctrl";
		eint = "/apirq@1000b000";
		apmixed = "/apmixed@1000c000";
		pwrap = "/pwrap@1000d000";
		main_pmic = "/pwrap@1000d000/mt6357-pmic";
		pmic = "/pwrap@1000d000/mt6357-pmic/mt-pmic";
		pmic_auxadc = "/pwrap@1000d000/mt6357-pmic/mt635x-auxadc";
		mt_pmic_vs1_buck_reg = "/pwrap@1000d000/mt6357-pmic/buck_regulators/buck_vs1";
		mt_pmic_vmodem_buck_reg = "/pwrap@1000d000/mt6357-pmic/buck_regulators/buck_vmodem";
		mt_pmic_vcore_buck_reg = "/pwrap@1000d000/mt6357-pmic/buck_regulators/buck_vcore";
		mt_pmic_vproc_buck_reg = "/pwrap@1000d000/mt6357-pmic/buck_regulators/buck_vproc";
		mt_pmic_vpa_buck_reg = "/pwrap@1000d000/mt6357-pmic/buck_regulators/buck_vpa";
		mt_pmic_vfe28_ldo_reg = "/pwrap@1000d000/mt6357-pmic/ldo_regulators/ldo_vfe28";
		mt_pmic_vxo22_ldo_reg = "/pwrap@1000d000/mt6357-pmic/ldo_regulators/ldo_vxo22";
		mt_pmic_vrf18_ldo_reg = "/pwrap@1000d000/mt6357-pmic/ldo_regulators/ldo_vrf18";
		mt_pmic_vrf12_ldo_reg = "/pwrap@1000d000/mt6357-pmic/ldo_regulators/ldo_vrf12";
		mt_pmic_vefuse_ldo_reg = "/pwrap@1000d000/mt6357-pmic/ldo_regulators/ldo_vefuse";
		mt_pmic_vcn33_bt_ldo_reg = "/pwrap@1000d000/mt6357-pmic/ldo_regulators/ldo_vcn33_bt";
		mt_pmic_vcn33_wifi_ldo_reg = "/pwrap@1000d000/mt6357-pmic/ldo_regulators/ldo_vcn33_wifi";
		mt_pmic_vcn28_ldo_reg = "/pwrap@1000d000/mt6357-pmic/ldo_regulators/ldo_vcn28";
		mt_pmic_vcn18_ldo_reg = "/pwrap@1000d000/mt6357-pmic/ldo_regulators/ldo_vcn18";
		mt_pmic_vcama_ldo_reg = "/pwrap@1000d000/mt6357-pmic/ldo_regulators/ldo_vcama";
		mt_pmic_vcamd_ldo_reg = "/pwrap@1000d000/mt6357-pmic/ldo_regulators/ldo_vcamd";
		mt_pmic_vcamio_ldo_reg = "/pwrap@1000d000/mt6357-pmic/ldo_regulators/ldo_vcamio";
		mt_pmic_vldo28_ldo_reg = "/pwrap@1000d000/mt6357-pmic/ldo_regulators/ldo_vldo28";
		mt_pmic_vsram_others_ldo_reg = "/pwrap@1000d000/mt6357-pmic/ldo_regulators/ldo_vsram_others";
		mt_pmic_vsram_proc_ldo_reg = "/pwrap@1000d000/mt6357-pmic/ldo_regulators/ldo_vsram_proc";
		mt_pmic_vaux18_ldo_reg = "/pwrap@1000d000/mt6357-pmic/ldo_regulators/ldo_vaux18";
		mt_pmic_vaud28_ldo_reg = "/pwrap@1000d000/mt6357-pmic/ldo_regulators/ldo_vaud28";
		mt_pmic_vio28_ldo_reg = "/pwrap@1000d000/mt6357-pmic/ldo_regulators/ldo_vio28";
		mt_pmic_vio18_ldo_reg = "/pwrap@1000d000/mt6357-pmic/ldo_regulators/ldo_vio18";
		mt_pmic_vdram_ldo_reg = "/pwrap@1000d000/mt6357-pmic/ldo_regulators/ldo_vdram";
		mt_pmic_vmc_ldo_reg = "/pwrap@1000d000/mt6357-pmic/ldo_regulators/ldo_vmc";
		mt_pmic_vmch_ldo_reg = "/pwrap@1000d000/mt6357-pmic/ldo_regulators/ldo_vmch";
		mt_pmic_vemc_ldo_reg = "/pwrap@1000d000/mt6357-pmic/ldo_regulators/ldo_vemc";
		mt_pmic_vsim1_ldo_reg = "/pwrap@1000d000/mt6357-pmic/ldo_regulators/ldo_vsim1";
		mt_pmic_vsim2_ldo_reg = "/pwrap@1000d000/mt6357-pmic/ldo_regulators/ldo_vsim2";
		mt_pmic_vibr_ldo_reg = "/pwrap@1000d000/mt6357-pmic/ldo_regulators/ldo_vibr";
		mt_pmic_vusb33_ldo_reg = "/pwrap@1000d000/mt6357-pmic/ldo_regulators/ldo_vusb33";
		pwraph = "/pwraphal@";
		keypad = "/kp@10010000";
		hwrng = "/hwrng";
		mdcldma = "/mdcldma@10014000";
		gce_mbox = "/gce_mbox@10228000";
		auxadc = "/auxadc@11001000";
		apuart0 = "/apuart0@11002000";
		apuart1 = "/apuart1@11003000";
		i2c_common = "/i2c_common";
		i2c0 = "/i2c@11007000";
		i2c1 = "/i2c@11008000";
		i2c2 = "/i2c@11009000";
		i2c3 = "/i2c@1100f000";
		i2c4 = "/i2c@11011000";
		i2c5 = "/i2c@11016000";
		spi0 = "/spi@1100a000";
		spi1 = "/spi@11010000";
		spi2 = "/spi@11012000";
		msdc0 = "/msdc@11230000";
		msdc0_pins_default = "/msdc@11230000/msdc0@default";
		msdc0_register_setting_default = "/msdc@11230000/msdc0@register_default";
		msdc1 = "/msdc@11240000";
		msdc1_pins_default = "/msdc@11240000/msdc1@default";
		msdc1_pins_sdr104 = "/msdc@11240000/msdc1@sdr104";
		msdc1_pins_sdr50 = "/msdc@11240000/msdc1@sdr50";
		msdc1_pins_ddr50 = "/msdc@11240000/msdc1@ddr50";
		msdc1_register_setting_default = "/msdc@11240000/msdc1@register_default";
		audio = "/audio@11220000";
		audgpio = "/mt_soc_dl1_pcm@11220000";
		btcvsd_snd = "/mtk-btcvsd-snd@18000000";
		mmsys_config = "/mmsys_config@14000000";
		touch = "/touch";
		flashlight_core = "/flashlight_core";
		flashlights_rt4505 = "/flashlights_rt4505";
		flashlights_aw3641 = "/flashlights_aw3641";
		mtkfb = "/mtkfb";
		disp_mutex = "/disp_mutex@14001000";
		smi_larb0 = "/smi_larb0@14003000";
		mdp_rdma0 = "/mdp_rdma0@14004000";
		mdp_rsz0 = "/mdp_rsz0@14005000";
		mdp_rsz1 = "/mdp_rsz1@14006000";
		mdp_wdma0 = "/mdp_wdma0@14007000";
		mdp_wrot0 = "/mdp_wrot0@14008000";
		mdp_tdshp0 = "/mdp_tdshp0@14009000";
		disp_ovl0 = "/disp_ovl0@1400a000";
		disp_aal0 = "/disp_aal0@1400f000";
		dispsys = "/dispsys@14000000";
		mm_mutex = "/mm_mutex@14016000";
		imgsys_config = "/imgsys_config@15000000";
		smi_larb2 = "/smi_larb2@15001000";
		venc_global_con = "/venc_global_con@17000000";
		venc = "/venc@17020000";
		smi_larb1 = "/smi_larb1@17010000";
		bat_gm30 = "/battery";
		mt_charger = "/mt_charger";
		charger = "/charger";
		pmic_clock_buffer_ctrl = "/pmic_clock_buffer_ctrl";
		consys = "/consys@18070000";
		goodix_fp = "/fingerprint";
		als = "/als_ps@0";
		gse_1 = "/gse_1";
		mse = "/mse";
		gyro = "/gyro";
		mrdump_ext_rst = "/mrdump_ext_rst";
		msdc1_ins = "/msdc1_ins";
		chr_stat = "/chr_stat";
		rt9465_slave_chr = "/rt9465_slave_chr";
		dsi_te = "/dsi_te";
		kd_camera_hw1 = "/kd_camera_hw1@15008000";
		otg_iddig = "/otg_iddig";
		nfc = "/nfc";
		irq_nfc = "/irq_nfc";
		md1_sim1_hot_plug_eint = "/md1_sim1_hot_plug_eint";
		md1_sim2_hot_plug_eint = "/md1_sim2_hot_plug_eint";
		irtx_pwm = "/irtx_pwm";
		odm = "/odm";
		radio_md_cfg = "/radio_md_cfg";
		dynamic_options = "/dynamic_options";
	};
};
